## embedded/drivers/pinctrl/Kconfig
```kconfig
menuconfig PINCTRL
	bool "Pin control drivers"
	help
	  将引脚控制驱动纳入系统配置，用于在设备驱动初始化前完成 IO 复用、
	  上下拉和默认输出状态配置。
```

## embedded/drivers/pinctrl/Kconfig.gd32
```kconfig
config PINCTRL_GD32
	bool "GD32 pin control driver"
	depends on SOC_SERIES_GD32F50X
	default y
	help
	  根据 DTS pinctrl 状态配置 GD32 的 GPIO 模式、复用功能、上下拉、
	  输出类型和默认输出电平。
```

## embedded/drivers/pwm/Kconfig.gd32
```kconfig
config PWM_GD32
    bool "GD32 PWM driver"
    select PWM
    default y if SOC_SERIES_GD32F50X
    depends on SOC_SERIES_GD32F50X
    help
      Enable GD32 PWM driver for GD32F50x series.
```

## embedded/drivers/spi/Kconfig
```kconfig
menuconfig SPI
	bool "SPI drivers"
	help
	  Include SPI drivers in system config

rsource "Kconfig.stm32"
rsource "Kconfig.gd32"

if SPI

config SPI_INIT_PRIORITY
	int "SPI init priority"
	default KERNEL_INIT_PRIORITY_DEFAULT
	help
	  SPI driver device initialization priority.

endif # SPI
```
