## app/demo/Kconfig
```kconfig
menu "Application Configuration"

config APP_NAME
    string "Application name"
    default "demo"

menu "Motor Parameters (DM-4340)"
    config MOTOR_TORQUE_CONSTANT
        int "Torque constant (mNm/A)"
        default 4074
    config MOTOR_GEAR_RATIO
        int "Gear ratio"
        default 40
    config MOTOR_POLE_PAIRS_APP
        int "Pole pairs"
        default 14
endmenu

menu "LESO Speed Controller"
    config LESO_OMEGA
        int "LESO bandwidth (rad/s)"
        default 3000
    config LESO_B0
        int "LESO control gain b0"
        default 6000
    config LESO_KP
        int "LESO proportional gain (milli)"
        default 6
endmenu

menu "Position Controller"
    config POS_KP
        int "Position PID Kp (milli)"
        default 6000
    config POS_KI
        int "Position PID Ki (milli)"
        default 0
    config POS_KD
        int "Position PID Kd (milli)"
        default 0
    config POS_OUTPUT_LIMIT
        int "Position PID output limit (milli rad/s)"
        default 3500
    config POS_BACKLASH_DEADZONE
        int "Backlash deadzone (millirad)"
        default 6
    config POS_BACKLASH_HYSTERESIS
        int "Backlash hysteresis (millirad)"
        default 10
    config POS_BACKLASH_CMD_THRESHOLD
        int "Backlash command threshold (milli rad/s)"
        default 1000
    config POS_BACKLASH_DWELL_TIME
        int "Backlash dwell time (ms)"
        default 1000
    config POS_CTRL_AUTO_CALIB
        bool "Auto-calibrate on first boot"
        default y
endmenu

menu "Protection Thresholds"
    config PROTECT_BUS_OV
        int "Bus overvoltage (mV)"
        default 45000
    config PROTECT_BUS_UV
        int "Bus undervoltage (mV)"
        default 12000
    config PROTECT_BOARD_OT
        int "Board overtemperature (dC)"
        default 1000
    config PROTECT_MOTOR_OT
        int "Motor overtemperature (dC)"
        default 1200
endmenu

menu "Temperature Sensors"
    config NTC_DIVIDER_RESISTANCE
        int "NTC voltage divider resistance (ohm)"
        default 10000
    config BOARD_TEMP_ADC_CHANNEL
        int "Board temperature ADC channel"
        default 16
    config MOTOR_TEMP_ADC_CHANNEL
        int "Motor temperature ADC channel"
        default 17
endmenu

menu "Sweep Signal"
    config SWEEP_FSTART
        int "Sweep start frequency (dHz)"
        default 1
    config SWEEP_FEND
        int "Sweep end frequency (dHz)"
        default 200
    config SWEEP_FGAP
        int "Sweep frequency step (dHz)"
        default 1
    config SWEEP_REPEAT
        int "Sweep repeat count per frequency"
        default 10
endmenu

endmenu
```

## app/demo_ble/Kconfig
```kconfig
menu "Application Configuration"

config APP_NAME
    string "Application name"
    default "demo_ble"

endmenu
```

## app/demo_gd32/Kconfig
```kconfig
# GD32F503 demo application Kconfig

menu "Application Configuration"

config APP_NAME
    string "Application name"
    default "demo_gd32"

endmenu
```

## component/foc/Kconfig.motor
```kconfig
# Motor-specific configuration overrides
# Board DTS or prj.conf can override these

config FOC_MOTOR_RS
    int "Override stator resistance (mOhm)"
    default 0
    help
      Override motor Rs. 0 = use FOC_RS_OHMS default.

config FOC_MOTOR_LS
    int "Override stator inductance (uH)"
    default 0
    help
      Override motor Ls. 0 = use FOC_LD/LQ default.
```

## component/nvs/Kconfig
```kconfig
menuconfig NVS
    bool "NVS (Non-Volatile Storage)"
    help
      NVS 追加日志 KV 存储，支持磨损均衡和掉电恢复。
      8 字节 ATE，16 位 ID，CRC-8 校验。

if NVS

config NVS_SECTOR_COUNT
    int "NVS 使用的扇区数"
    default 3
    range 2 16
    help
      最少 2 个。更多扇区减少 GC 频率，改善磨损均衡。

config NVS_DATA_CRC
    bool "启用数据 CRC-32 校验"
    default y
    help
      数据条目附加 CRC-32，增加 4 字节开销。

endif # NVS
```

## embedded/Kconfig
```kconfig
menu "Embedded Configure"

rsource "dts/Kconfig"

menu "Device Options"

config DEVICE_DEPS
	bool "Store device dependencies"
	help
	  When enabled, device dependencies will be stored so that they can be
	  queried at runtime. Device dependencies are typically inferred from
	  devicetree. Enabling this option will increase ROM usage (or RAM if
	  dynamic device dependencies are enabled).

config DEVICE_DEPS_DYNAMIC
	bool "Dynamic device dependencies"
	depends on DEVICE_DEPS
	help
	  Option that makes it possible to manipulate device dependencies at
	  runtime.

config DEVICE_MUTABLE
	bool "Mutable devices [EXPERIMENTAL]"
	select EXPERIMENTAL
	help
	  Support mutable devices. Mutable devices are instantiated in SRAM
	  instead of Flash and are runtime modifiable in kernel mode.

config DEVICE_DT_METADATA
	bool "Store additional devicetree metadata for each device"
	help
	  If enabled, additional data from the devicetree will be stored for
	  each device. This allows you to use device_get_by_dt_nodelabel(),
	  device_get_dt_metadata(), etc.

config DEVICE_DEINIT_SUPPORT
	bool "Support device de-initialization"
	default y
	help
	  In very specific case, it might be necessary to de-initialize
	  a device at runtime. This is possible by providing a function
	  to do so. Note, that this will grow every struct device by a
	  function pointer. All device drivers that use the relevant
	  macros and provide such function should select this option.

endmenu

menu "Initialization Priorities"

config KERNEL_INIT_PRIORITY_OBJECTS
	int "Kernel objects initialization priority"
	default 30
	help
	  Kernel objects use this priority for initialization. This
	  priority needs to be higher than minimal default initialization
	  priority.

config KERNEL_INIT_PRIORITY_LIBC
	int "LIBC initialization priority"
	default 35
	help
	  LIBC uses this priority for initialization. This
	  priority needs to be higher than minimal default initialization
	  priority.

config KERNEL_INIT_PRIORITY_DEFAULT
	int "Default init priority"
	default 40
	help
	  Default minimal init priority for each init level.

config KERNEL_INIT_PRIORITY_DEVICE
	int "Default init priority for device drivers"
	default 50
	help
	  Device driver, that depends on common components, such as
	  interrupt controller, but does not depend on other devices,
	  uses this init priority.

config APPLICATION_INIT_PRIORITY
	int "Default init priority for application level drivers"
	default 90
	help
	  This priority level is for end-user drivers such as sensors and display
	  which have no inward dependencies.

endmenu

config SYS_CLOCK_EXISTS
	bool "System clock exists and is enabled"
	default y
	help
	  This option specifies that the kernel has timer support.

	  Some device configurations can eliminate significant code if
	  this is disabled.  Obviously timeout-related APIs will not
	  work when disabled.

config SYS_CLOCK_TICKS_PER_SEC
	int "System tick frequency (in ticks/second)"
	default 1000
	help
	  This option specifies the nominal frequency of the system clock in Hz.

	  For asynchronous timekeeping, the kernel defines a "ticks" concept. A
	  "tick" is the internal count in which the kernel does all its internal
	  uptime and timeout bookkeeping. Interrupts are expected to be delivered
	  on tick boundaries to the extent practical, and no fractional ticks
	  are tracked.

	  The choice of tick rate is configurable by this option. Also the number
	  of cycles per tick should be chosen so that 1 millisecond is exactly
	  represented by an integral number of ticks. Defaults on most hardware
	  platforms (ones that support setting arbitrary interrupt timeouts) are
	  expected to be in the range of 10 kHz, with software emulation
	  platforms and legacy drivers using a more traditional 100 Hz value.

	  Note that when available and enabled, in "tickless" mode
	  this config variable specifies the minimum available timing
	  granularity, not necessarily the number or frequency of
	  interrupts delivered to the kernel.

	  A value of 0 completely disables timer support in the kernel.

config SYS_CLOCK_HW_CYCLES_PER_SEC
	int "System clock's h/w timer frequency"
	default 0 if TIMER_READS_ITS_FREQUENCY_AT_RUNTIME
	depends on SYS_CLOCK_EXISTS
	help
	  This option specifies the frequency of the hardware timer used for the
	  system clock (in Hz). This option is set by the SOC's or board's Kconfig file
	  and the user should generally avoid modifying it via the menu configuration.

config HAS_FLASH_LOAD_OFFSET
	bool
	help
	  This option is selected by targets having a FLASH_LOAD_OFFSET
	  and FLASH_LOAD_SIZE.
if HAS_FLASH_LOAD_OFFSET

config USE_DT_CODE_PARTITION
	bool "Link application into /chosen/msdk,code-partition from devicetree"
	help
	  When enabled, the application will be linked into the flash partition
	  selected by the zephyr,code-partition property in /chosen in devicetree.
	  When this is disabled, the flash load offset and size can be set manually
	  below.

# Workaround for not being able to have commas in macro arguments
DT_CHOSEN_Z_CODE_PARTITION := msdk,code-partition

config FLASH_LOAD_OFFSET
	# Only user-configurable when USE_DT_CODE_PARTITION is disabled
	hex "Kernel load offset" if !USE_DT_CODE_PARTITION
	default $(dt_chosen_reg_addr_hex,$(DT_CHOSEN_Z_CODE_PARTITION)) if USE_DT_CODE_PARTITION
	default 0
	help
	  This option specifies the byte offset from the beginning of flash that
	  the kernel should be loaded into. Changing this value from zero will
	  affect the Zephyr image's link, and will decrease the total amount of
	  flash available for use by application code.

	  If unsure, leave at the default value 0.

config FLASH_LOAD_SIZE
	# Only user-configurable when USE_DT_CODE_PARTITION is disabled
	hex "Kernel load size" if !USE_DT_CODE_PARTITION
	default $(dt_chosen_reg_size_hex,$(DT_CHOSEN_Z_CODE_PARTITION)) if USE_DT_CODE_PARTITION
	default 0
	help
	  If non-zero, this option specifies the size, in bytes, of the flash
	  area that the Zephyr image will be allowed to occupy.  If zero, the
	  image will be able to occupy from the FLASH_LOAD_OFFSET to the end of
	  the device.

	  If unsure, leave at the default value 0.

endif  # HAS_FLASH_LOAD_OFFSET

config SWAP_NONATOMIC
	bool
	help
	  On some architectures, the z_swap() primitive cannot be made
	  atomic with respect to the irq_lock being released.  That
	  is, interrupts may be received between the entry to z_swap
	  and the completion of the context switch.  There are a
	  handful of workaround cases in the kernel that need to be
	  enabled when this is true.  Currently, this only happens on
	  ARM when the PendSV exception priority sits below that of
	  Zephyr-handled interrupts.

menu "Barrier Operations"
config BARRIER_OPERATIONS_BUILTIN
	bool
	help
	  Use the compiler builtin functions for barrier operations. This is
	  the preferred method. However, support for all arches in GCC is
	  incomplete.

config BARRIER_OPERATIONS_ARCH
	bool
	help
	  Use when there isn't support for compiler built-ins, but you have
	  written optimized assembly code under arch/ which implements these.
endmenu

menu "Atomic Operations"
config ATOMIC_OPERATIONS_BUILTIN
	bool
	help
	  Use the compiler builtin functions for atomic operations. This is
	  the preferred method. However, support for all arches in GCC is
	  incomplete.

config ATOMIC_OPERATIONS_ARCH
	bool
	help
	  Use when there isn't support for compiler built-ins, but you have
	  written optimized assembly code under arch/ which implements these.

config ATOMIC_OPERATIONS_C
	bool
	help
	  Use atomic operations routines that are implemented entirely
	  in C by locking interrupts. Selected by architectures which either
	  do not have support for atomic operations in their instruction
	  set, or haven't been implemented yet during bring-up, and also
	  the compiler does not have support for the atomic __sync_* builtins.
endmenu

# zephyr-keep-sorted-start
source "embedded/arch/Kconfig"
source "embedded/drivers/Kconfig"
source "embedded/modules/Kconfig"
source "embedded/soc/Kconfig"
source "embedded/system/Kconfig"
# zephyr-keep-sorted-stop

endmenu
```

## embedded/arch/arm/core/cortex_m/tz/Kconfig
```kconfig
config ARM_TRUSTZONE_M
	bool "ARM TrustZone-M support"
	depends on CPU_HAS_TEE
	depends on ARMV8_M_SE
	help
	  Platform has support for ARM TrustZone-M.

if ARM_TRUSTZONE_M
endif
```

## embedded/drivers/adc/Kconfig
```kconfig
menuconfig ADC
    bool "ADC drivers"
    help
      Include ADC drivers in system config

rsource "Kconfig.gd32"

if ADC

config ADC_INIT_PRIORITY
    int "ADC init priority"
    default KERNEL_INIT_PRIORITY_DEFAULT
    help
      ADC driver device initialization priority.

endif # ADC
```

## embedded/drivers/adc/Kconfig.gd32
```kconfig
config ADC_GD32
    bool "GD32 ADC driver"
    select ADC
    default y if SOC_SERIES_GD32F50X
    depends on SOC_SERIES_GD32F50X
    help
      Enable GD32 SAR-ADC driver for GD32F50x series.
```

## embedded/drivers/clock_control/Kconfig
```kconfig
menuconfig CLOCK_CONTROL
	bool "Clock controller drivers"
	help
	  Enable support for hardware clock controller. Such hardware can
	  provide clock for other subsystem, and thus can be also used for
	  power efficiency by controlling their clock. Note that this has
	  nothing to do with RTC.

if CLOCK_CONTROL

config CLOCK_CONTROL_INIT_PRIORITY
	int "Clock control init priority"
	default KERNEL_INIT_PRIORITY_OBJECTS
	help
	  Clock control driver device initialization priority.

module = CLOCK_CONTROL
module-str = clock control

rsource "Kconfig.stm32"

endif # CLOCK_CONTROL
```

## embedded/drivers/dma/Kconfig
```kconfig
menuconfig DMA
	bool "DMA drivers"
	help
	  Include DMA drivers in system config

rsource "Kconfig.gd32"

if DMA

config DMA_INIT_PRIORITY
	int "DMA init priority"
	default KERNEL_INIT_PRIORITY_DEFAULT
	help
	  DMA driver device initialization priority.

endif # DMA
```

## embedded/drivers/flash/Kconfig
```kconfig
menuconfig FLASH
	bool "Flash drivers"
	help
	  Include Flash drivers in system config

rsource "Kconfig.stm32"
rsource "Kconfig.gd32"

if FLASH

config FLASH_INIT_PRIORITY
	int "Flash init priority"
	default KERNEL_INIT_PRIORITY_DEFAULT
	help
	  Flash driver device initialization priority.

endif # FLASH
```

## embedded/drivers/gpio/Kconfig
```kconfig
menuconfig GPIO
	bool "General-Purpose Input/Output (GPIO) drivers"
	help
	  Include GPIO drivers in system config

rsource "Kconfig.stm32"
rsource "Kconfig.gd32"
rsource "Kconfig.gr5525"

if GPIO

config GPIO_INIT_PRIORITY
	int "GPIO init priority"
	default KERNEL_INIT_PRIORITY_DEFAULT
	help
	  GPIO driver device initialization priority.

config GPIO_GET_DIRECTION
	bool "Support for querying GPIO direction [EXPERIMENTAL]"
	select EXPERIMENTAL
	help
	  Enable this option if the application does not maintain its own GPIO
	  direction state.

	  With this option enabled, the application may query GPIO direction
	  via gpio_port_get_direction(), gpio_pin_is_input(), and
	  gpio_pin_is_output().

config GPIO_GET_CONFIG
	bool "Support for get configuration function [EXPERIMENTAL]"
	select EXPERIMENTAL
	help
	  This option enables the support for getting the current configurations
	  of GPIOs. The driver must implement it to work.

endif # GPIO
```

## embedded/drivers/gpio/Kconfig.gd32
```kconfig
config GPIO_GD32
	bool "GPIO Driver for GD32 family of MCUs"
	select GPIO
	default y
	depends on DT_HAS_GD_GD32_GPIO_ENABLED
	help
	  Enable GPIO driver for GD32 line of MCUs
```

## embedded/drivers/i2c/Kconfig
```kconfig
menuconfig I2C
	bool "I2C drivers"
	help
	  Include I2C drivers in system config

rsource "Kconfig.stm32"

if I2C

config I2C_INIT_PRIORITY
	int "I2C init priority"
	default KERNEL_INIT_PRIORITY_DEFAULT
	help
	  I2C driver device initialization priority.

endif # I2C
```

## embedded/drivers/interrupt_controller/Kconfig
```kconfig
menu "Interrupt controller drivers"

config INTC_INIT_PRIORITY
	int "Interrupt controller init priority"
	default KERNEL_INIT_PRIORITY_DEFAULT
	help
	  Interrupt controller device initialization priority.

module = INTC
module-str = intc
rsource "Kconfig.stm32"
endmenu
```
