## Kconfig
```kconfig
mainmenu "RTOS-SDK Configuration"
source "$(KCONFIG_BINARY_DIR)/Kconfig.modules"

source "bootloader/common/Kconfig"
config SDK_OPTIMIZE_FOR_SIZE
    bool "Optimize the firmware image for size"
    help
      Use size-oriented compilation and GNU link-time optimization for SDK targets.

source "embedded/Kconfig"
source "component/Kconfig"
osource "$(PROJECT_DIR)/Kconfig"
```

## app/product/demo_foc/Kconfig
```kconfig
menu "FOC Motor Application"
config APP_NAME
    string "Application name"
    default "demo_foc"
config DEMO_FOC_CANOPEN_NODE_ID
    int "Joint CANopen FD node ID"
    range 1 127
    default 1

config DEMO_FOC_JOINT_MOTION
    bool "Enable demo joint motion after board commissioning"
    help
      Allow calibrated motor operation and enable joint brake sequencing.
      Requires verified phase order, dead time, brake operation and joint limits.
endmenu
```

## app/product/demo_foc/config/board_defconfig
```kconfig
CONFIG_SOC_SERIES_GD32F50X=y
CONFIG_GD32F50X_HXTAL_12MHZ=y
CONFIG_GD32F50X_PLL_192MHZ=y
CONFIG_SYS_CLOCK_HW_CYCLES_PER_SEC=192000000
```

## app/product/demo_foc/dts/bindings/rtos_sdk,md007-control.yaml
```yaml
description: Product FOC acquisition and PWM timing
compatible: "rtos_sdk,md007-control"
include: base.yaml
properties:
  current-channels:
    type: array
    required: true
  joint-channels:
    type: array
    required: true
  temperature-channels:
    type: array
    required: true
  timer-clock-hz:
    type: int
    required: true
  pwm-frequency-hz:
    type: int
    required: true
  adc-before-peak-ns:
    type: int
    required: true
  current-triggers:
    type: phandle-array
    specifier-space: trigger
    required: true
  joint-triggers:
    type: phandle-array
    specifier-space: trigger
    required: true
  brake-enable-gpios:
    type: phandle-array
    description: Brake power supply enable.
  brake-voltage-select-gpios:
    type: phandle-array
    description: Brake power supply voltage selection.
```

## bootloader/preloader/Kconfig
```kconfig
menu "Preloader Configuration"

comment "Product identity is defined by app/product/<name>/config/layout.json"

endmenu
```

## component/algo/Kconfig
```kconfig
menu "Reusable algorithms"

config ATTITUDE_EKF
    bool "Error-state attitude EKF"

config THERMAL_CONTROL
    bool "Closed-loop thermal control"

endmenu
```

## component/link/Kconfig
```kconfig
menuconfig LINK
	bool "Link communication stack"
	default n
	depends on OSAL_HAS_THREADS
	depends on OSAL_HAS_STATIC_THREADS
	depends on OSAL_HAS_STATIC_PERIODIC_THREADS
	depends on OSAL_HAS_MESSAGE_QUEUES

if LINK

config LINK_MAX_FRAME_SIZE
	int "Maximum frame size (bytes)"
	range 16 1023
	default 512

config LINK_MAX_LINKS
	int "Maximum physical links"
	range 1 255
	default 8

config LINK_MAX_ROUTES
	int "Maximum static route rules"
	range 1 1024
	default 16

config LINK_MAX_PENDING
	int "Maximum requests awaiting ACK"
	range 1 1024
	default 8

config LINK_ACK_NOW_TIMEOUT_MS
	int "Delivery ACK timeout (ms)"
	range 1 1000
	default 50
	help
	  Retry interval while a request has not yet been accepted by its peer.

config LINK_ACK_NOW_RETRIES
	int "Delivery retry count"
	range 0 10
	default 2
	help
	  Maximum retransmissions before an ACK_NOW request, or the delivery
	  stage of a staged request, is reported as timed out.

config LINK_MAX_LOCAL_ADDRESSES
	int "Maximum local protocol addresses"
	range 1 16
	default 4
	help
	  One Router can terminate commands for several logical hosts while the
	  first configured address remains the source for locally initiated frames.

config LINK_WORK_QUEUE_DEPTH
	int "Per-priority handler work queue depth"
	range 2 32
	default 4
	help
	  High- and low-priority requests use separate statically allocated queues.
	  The parser never blocks waiting for business handlers.

config LINK_HIGH_PRIORITY_BURST
	int "Maximum consecutive high-priority handler requests"
	range 1 32
	default 4
	help
	  Services low-priority work after this many high-priority requests when
	  both queues are non-empty, preventing starvation without losing priority.

config LINK_MAX_ASYNC_REQUESTS
	int "Maximum deferred handler completions"
	range 1 32
	default 4
	help
	  Bounds the number of long-running requests holding completion tokens.

config LINK_REPLAY_CACHE_SIZE
	int "Acknowledged request replay-cache entries"
	range 1 256
	default 16
	help
	  Completed acknowledged requests are retained here so a retransmission
	  replays the previous ACK without executing the command twice.

config LINK_REPLAY_RETENTION_MS
	int "Acknowledged request replay retention (ms)"
	range 100 60000
	default 10000
	help
	  Must exceed the longest sender retry horizon. Sequence reuse is accepted
	  only after this interval has elapsed. Every asynchronous handler timeout
	  and sender completion timeout must be strictly shorter than this interval.

config LINK_REPLAY_RESPONSE_SIZE
	int "Maximum cached ACK response data (bytes)"
	range 16 1009
	default 320
	help
	  Bounds RAM used to replay response data without executing a duplicate
	  request. The effective limit is also capped by LINK_MAX_FRAME_SIZE.

config LINK_SECURITY
	bool "Product-provided authenticated encryption"
	default n
	help
	  Compile and require app/product/<product>/common/link_security.cc.
	  Enable this for selective LINK_SECURE_HANDLER commands as well as the
	  global plaintext-rejection policy.

config LINK_REQUIRE_SECURE_COMMANDS
	bool "Reject all plaintext commands"
	select LINK_SECURITY
	default n
	help
	  Require authenticated encryption for every locally handled command.

config LINK_PROCESS_HZ
	int "Link parser task frequency (Hz)"
	range 1 SYS_CLOCK_TICKS_PER_SEC
	default 1000

config LINK_PROCESS_STACK
	int "Link parser task stack size (bytes)"
	range 1024 65536
	default 2048

config LINK_PROCESS_PRIO
	int "Link parser task priority"
	range 0 31
	default 5

config LINK_WORKER_STACK
	int "Link handler worker stack size (bytes)"
	range 2048 65536
	default 4096

config LINK_WORKER_PRIO
	int "Link handler worker priority"
	range 0 31
	default 4
	help
	  Keep the parser task above this worker so transport draining, ACK matching,
	  and timeout maintenance remain deterministic under slow business handlers.

config LINK_INIT_PRIORITY
	int "Link lifecycle init priority"
	range 81 98
	default 95
	help
	  Router must start after all generated Link transport devices (currently
	  priority 80 or lower) and before the system watchdog monitor at 99. This
	  also guarantees reverse-order shutdown before those devices are deinit.

config LINK_PROCESS_RX_BUDGET
	int "Maximum received bytes per link and process cycle"
	range 16 8192
	default 1024
	help
	  Bounds one transport's work per Router cycle so malformed or continuous
	  traffic cannot starve other links, ACK timeouts, or health monitoring.

config LINK_UART_TX_TIMEOUT_MS
	int "UART link bounded transmit timeout (ms)"
	range 1 5000
	default 100
	help
	  Maximum time the dedicated Link processing task may wait for one UART
	  frame to finish. Size this from baud rate and LINK_MAX_FRAME_SIZE.

config LINK_DIAGNOSTICS
	bool "Versioned remote Link diagnostics command"
	default y
	help
	  Reserves one command for bounded, versioned aggregate and per-link runtime
	  counters. Requests must be unicast and use FINISH or PROGRESS ACK mode.

config LINK_DIAGNOSTICS_COMMAND_SET
	hex "Remote diagnostics command set"
	range 0x01 0xFE
	default 0xFE
	depends on LINK_DIAGNOSTICS

config LINK_DIAGNOSTICS_REQUIRE_SECURE
	bool "Require authenticated diagnostics requests"
	default y
	depends on LINK_DIAGNOSTICS && LINK_SECURITY
	help
	  Prevents unauthenticated peers from learning topology and fault counters.

endif

config LINK_CAN_TX_DEPTH
    int "Whole CAN frames queued per transport"
    default 2
    range 1 8
    depends on LINK && CAN

config LINK_SYSTEM_DIAGNOSTICS
    bool "Expose system diagnostic snapshots over Link"
    default y
    depends on LINK && LINK_MAX_FRAME_SIZE >= 114
```

## embedded/drivers/adc/Kconfig
```kconfig
menuconfig ADC
    bool "ADC drivers"
    help
      Include ADC drivers in system config

rsource "Kconfig.gd32"
```

## embedded/drivers/can/Kconfig
```kconfig
menuconfig CAN
	bool "CAN drivers"
	help
	  Include CAN drivers in system config

rsource "Kconfig.stm32"
rsource "Kconfig.gd32"
```

## embedded/drivers/clock_control/Kconfig
```kconfig
menuconfig CLOCK_CONTROL
	bool "Clock controller drivers"
	help
	  Enable support for hardware clock controller. Such hardware can
	  provide clock for other subsystem, and thus can be also used for
	  power efficiency by controlling their clock. Note that this has
	  nothing to do with RTC.

if CLOCK_CONTROL

module = CLOCK_CONTROL
module-str = clock control

rsource "Kconfig.stm32"

endif # CLOCK_CONTROL
```

## embedded/drivers/dma/Kconfig
```kconfig
menuconfig DMA
	bool "DMA drivers"
	help
	  Include DMA drivers in system config

rsource "Kconfig.gd32"
```

## embedded/drivers/flash/Kconfig
```kconfig
menuconfig FLASH
	bool "Flash drivers"
	help
	  Include Flash drivers in system config

rsource "Kconfig.stm32"
rsource "Kconfig.gd32"
rsource "Kconfig.goodix"
```

## embedded/drivers/i2c/Kconfig
```kconfig
menuconfig I2C
	bool "I2C drivers"
	help
	  Include I2C drivers in system config

rsource "Kconfig.stm32"
```

## embedded/drivers/interrupt_controller/Kconfig
```kconfig
menu "Interrupt controller drivers"

module = INTC
module-str = intc
rsource "Kconfig.stm32"
endmenu
```

## embedded/drivers/pwm/Kconfig
```kconfig
menuconfig PWM
	bool "PWM drivers"
	help
	  Include PWM drivers in system config

rsource "Kconfig.stm32"
rsource "Kconfig.gd32"
```

## embedded/drivers/spi/Kconfig
```kconfig
menuconfig SPI
	bool "SPI drivers"
	help
	  Include SPI drivers in system config

rsource "Kconfig.stm32"
rsource "Kconfig.gd32"
rsource "Kconfig.gr5525"
```

## embedded/drivers/uart/Kconfig
```kconfig
menuconfig UART
	bool "UART drivers"
	help
	  Include UART drivers in system config

rsource "Kconfig.stm32"
rsource "Kconfig.gd32"
rsource "Kconfig.gr5525"
```

## embedded/dts/bindings/adc/gd,gd32-adc-scan.yaml
```yaml
description: GD32 ADC with timer-triggered circular DMA acquisition
compatible: "gd,gd32-adc-scan"
include: gd32-adc-common.yaml

cxx-driver:
  kconfig: ADC_GD32
  capabilities: [dma, triggered-scan]
  adapter:
    header: device_adapters/adc_dt.h
    macro: HAL_GD32_ADC_SCAN_DT_ADAPT
  type-name: Adc
  init: true
  interrupts:
    - name: dma-rx
      method: isr_dma_rx
      uses-osal: false
      enable-on-init: true
      source:
        phandle-array: dmas
        entry: rx
        interrupt-index-cell: channel
  requires:
    - phandle-array: dmas
      lifecycle: external
  readiness: is-initialized
  init-level: pre-kernel-2
  init-priority: 30

properties:
  oversampling-ratio:
    type: int
    default: 1
    enum: [1, 2, 4, 8, 16, 32, 64, 128, 256]
  oversampling-shift:
    type: int
    default: 0
    enum: [0, 1, 2, 3, 4, 5, 6, 7, 8]
  dmas:
    required: true
  dma-names:
    required: true
```

## embedded/dts/bindings/adc/gd,gd32-adc.yaml
```yaml
description: GD32 ADC controller

compatible: "gd,gd32-adc"

include: gd32-adc-common.yaml

cxx-driver:
  kconfig: ADC_GD32
  adapter:
    header: device_adapters/adc_dt.h
    macro: HAL_ADC_DT_ADAPT
  type-name: Adc
  init: true
  interrupts:
    - name: global
      method: isr_global
      uses-osal: true
      enable-on-init: true
  readiness: is-initialized
  init-level: pre-kernel-2
  init-priority: 30
```

## embedded/dts/bindings/adc/gd32-adc-common.yaml
```yaml
description: GD32 ADC controller properties
include: [adc-controller.yaml, base.yaml, pinctrl-device.yaml]

properties:
  reg:
    type: array
    required: true

  interrupts:
    type: array
    required: true

  resolution:
    type: int
    default: 12
    enum: [6, 8, 10, 12]

  label:
    type: string
    required: true
```

## embedded/dts/bindings/can/gd,gd32-can.yaml
```yaml
description: GD32 CAN controller

compatible: "gd,gd32-can"

include: [can-fd-controller.yaml, pinctrl-device.yaml]

cxx-driver:
  kconfig: CAN_GD32
  capabilities: [read, write]
  capabilities-if:
    can-fd: fd-enabled
  adapter:
    header: device_adapters/can_dt.h
    macro: HAL_CAN_DT_ADAPT
  type-name: CanDriver
  init: true
  readiness: is-initialized
  init-level: pre-kernel-2
  init-priority: 25

properties:
  reg:
    type: array
    required: true

  port:
    type: int
    required: true
    description: Zero-based GD32 CAN controller index

  interrupts:
    type: array
    required: true

  pinctrl-0:
    required: true

  pinctrl-names:
    required: true

  bitrate:
    type: int
    default: 500000

  fd-enabled:
    type: boolean
    description: Enable ISO CAN FD framing on this controller.

  tdc-offset:
    type: int
    default: 0
    description: Secondary sample point offset in CAN clock periods. Zero disables TDC.

  label:
    type: string
    required: true
```

## embedded/dts/bindings/misc/app,foc-control.yaml
```yaml
description: Product FOC acquisition and PWM timing
compatible: "app,foc-control"
include: base.yaml
properties:
  current-channels:
    type: array
    required: true
  joint-channels:
    type: array
    required: true
  temperature-channels:
    type: array
    required: true
  timer-clock-hz:
    type: int
    required: true
  pwm-frequency-hz:
    type: int
    required: true
  adc-before-peak-ns:
    type: int
    required: true
  current-trigger-input:
    type: int
    required: true
  joint-trigger-input:
    type: int
    required: true
  brake-enable-gpios:
    type: phandle-array
    description: Brake power supply enable.
  brake-voltage-select-gpios:
    type: phandle-array
    description: Brake power supply voltage selection.
```

## embedded/soc/gd/gd32f50x/Kconfig
```kconfig
# GigaDevice GD32F50x series SoC configuration

config SOC_GD32F50X
    bool
    select ARM
    select CPU_CORTEX_M33
    select CPU_HAS_FPU

config SOC
    string
    default "gd32f50x"

config SOC_NAME
    string
    default "GD32F50X"

config GD32F50X_HXTAL_12MHZ
    bool "GD32F50x board has a 12 MHz HXTAL"
    depends on SOC_SERIES_GD32F50X
    help
      Select the PLL input divider for a 12 MHz board crystal.
      Without this option the system clock assumes an 8 MHz crystal.

config GD32F50X_PLL_192MHZ
    bool "Run GD32F50x PLL at 192 MHz"
    depends on SOC_SERIES_GD32F50X
    help
      This supplies a 192 MHz APB2 kernel clock for exact
      8 Mbit/s CAN FD timing.
```

## tests/fixtures/external_module/Kconfig
```kconfig
config EXTERNAL_MODULE_PROBE
    bool "External module contract probe"
    default y
```
