## Kconfig
```kconfig
mainmenu "RTOS-SDK Configuration"

source "bootloader/common/Kconfig"
source "embedded/Kconfig"
source "component/Kconfig"
osource "$(PROJECT_DIR)/Kconfig"
```

## app/product/demo/Kconfig
```kconfig
menu "Application Configuration"

config APP_NAME
    string "Application name"
    default "demo"

menu "Motor Parameters (DM-4340)"
    config MOTOR_TORQUE_CONSTANT
        int "Torque constant (mNm/A)"
        range 1 1000000
        default 4074
    config MOTOR_GEAR_RATIO
        int "Gear ratio"
        range 1 10000
        default 40
endmenu

menu "LESO Speed Controller"
    config LESO_OMEGA
        int "LESO bandwidth (rad/s)"
        range 1 100000
        default 3000
    config LESO_B0
        int "LESO control gain b0"
        range 1 1000000
        default 6000
    config LESO_KP
        int "LESO proportional gain (milli)"
        range 0 1000000
        default 6
endmenu

menu "Position Controller"
    config POS_KP
        int "Position PID Kp (milli)"
        range 0 1000000
        default 6000
    config POS_KI
        int "Position PID Ki (milli)"
        range 0 1000000
        default 0
    config POS_KD
        int "Position PID Kd (milli)"
        range 0 1000000
        default 0
    config POS_OUTPUT_LIMIT
        int "Position PID output limit (milli rad/s)"
        range 1 1000000
        default 3500
    config POS_BACKLASH_DEADZONE
        int "Backlash deadzone (millirad)"
        range 0 1000000
        default 6
    config POS_BACKLASH_HYSTERESIS
        int "Backlash hysteresis (millirad)"
        range 0 1000000
        default 10
    config POS_BACKLASH_CMD_THRESHOLD
        int "Backlash command threshold (milli rad/s)"
        range 0 1000000
        default 1000
    config POS_BACKLASH_DWELL_TIME
        int "Backlash dwell time (ms)"
        range 0 3600000
        default 1000
    config POS_CTRL_AUTO_CALIB
        bool "Auto-calibrate on first boot"
        default y
endmenu

menu "Protection Thresholds"
    config PROTECT_BUS_OV
        int "Bus overvoltage (mV)"
        range 1 1000000
        default 45000
    config PROTECT_BUS_UV
        int "Bus undervoltage (mV)"
        range 1 1000000
        default 12000
    config PROTECT_BOARD_OT
        int "Board overtemperature (dC)"
        range 1 3000
        default 1000
    config PROTECT_MOTOR_OT
        int "Motor overtemperature (dC)"
        range 1 3000
        default 1200
endmenu

menu "Temperature Sensors"
    config NTC_DIVIDER_RESISTANCE
        int "NTC voltage divider resistance (ohm)"
        range 1 10000000
        default 10000
    config BOARD_TEMP_ADC_CHANNEL
        int "Board temperature ADC channel"
        range 0 255
        default 16
    config MOTOR_TEMP_ADC_CHANNEL
        int "Motor temperature ADC channel"
        range 0 255
        default 17
endmenu

menu "Sweep Signal"
    config SWEEP_FSTART
        int "Sweep start frequency (dHz)"
        range 1 1000000
        default 1
    config SWEEP_FEND
        int "Sweep end frequency (dHz)"
        range 1 1000000
        default 200
    config SWEEP_FGAP
        int "Sweep frequency step (dHz)"
        range 1 1000000
        default 1
    config SWEEP_REPEAT
        int "Sweep repeat count per frequency"
        range 1 1000000
        default 10
endmenu

endmenu
```

## app/product/demo_ble/Kconfig
```kconfig
menu "Application Configuration"

config APP_NAME
    string "Application name"
    default "demo_ble"

config APP_BLE_OWNER_PRIORITY
    int "BLE command owner priority"
    default 6
    range 1 30

config APP_HID_TASK_PRIORITY
    int "HID task priority"
    depends on BLE_HID
    default 5
    range 1 30

config APP_HID_TASK_STACK_SIZE
    int "HID task stack size (bytes)"
    depends on BLE_HID
    default 1024
    range 512 4096

config APP_HID_DEBOUNCE_MS
    int "HID key debounce time (milliseconds)"
    depends on BLE_HID
    default 20
    range 1 200

config APP_UART_TASK_PRIORITY
    int "UART bridge task priority"
    depends on BLE_UART_SERVICE
    default 4
    range 1 30

config APP_UART_TASK_STACK_SIZE
    int "UART bridge task stack size (bytes)"
    depends on BLE_UART_SERVICE
    default 1024
    range 512 4096

config APP_RUNTIME_DIAGNOSTICS
    bool "Periodic RTOS resource diagnostics"
    default y

config APP_RUNTIME_DIAGNOSTICS_INTERVAL_MS
    int "Resource diagnostics interval (milliseconds)"
    depends on APP_RUNTIME_DIAGNOSTICS
    default 60000
    range 5000 3600000

endmenu
```

## app/product/gimbal/Kconfig
```kconfig
menuconfig GIMBAL
    bool "Three-axis handheld gimbal product"
    select ATTITUDE_EKF
    select FEEDBACK_CONTROL
    select FOC
    select MOTION
    select POSITION_SENSOR
    select SAFETY_SUPERVISOR
    select THERMAL_CONTROL
    help
      Enable the gimbal product composition. Reusable algorithms remain in
      function-oriented components; this symbol only owns product policy,
      scheduling and hardware capability selection.

if GIMBAL

menu "Gimbal Product Configuration"

config APP_NAME
    string "Application name"
    default "gimbal"

choice GIMBAL_MOTOR_CONTROL_MODE
    prompt "Gimbal motor control mode"
    default GIMBAL_MOTOR_VOLTAGE_FOC

config GIMBAL_MOTOR_VOLTAGE_FOC
    bool "Hall-sensored voltage FOC"
    select FOC_VOLTAGE_CONTROL
    help
      Baseline mode without phase-current sampling. This is not a torque loop.

config GIMBAL_MOTOR_CURRENT_FOC
    bool "Phase-current closed-loop FOC"
    depends on DT_HAS_FOC_MOTOR_ENABLED
    select FOC_CURRENT_CONTROL

endchoice

config GIMBAL_CONTROL_HZ
    int "Attitude and rate control frequency"
    range 500 2000
    default 1000

config GIMBAL_SENSOR_HZ
    int "Synchronous sensor trigger frequency"
    range 8000 32000
    default 16000
    help
      Hardware timer rate used to launch asynchronous sensor DMA. It must be
      an integer multiple of GIMBAL_CONTROL_HZ.

config GIMBAL_PLANNER_HZ
    int "Motion planner frequency"
    range 100 500
    default 200

config GIMBAL_THERMAL_HZ
    int "IMU thermal controller frequency"
    range 10 100
    default 20

config GIMBAL_SUPERVISOR_HZ
    int "Safety supervisor frequency"
    range 10 200
    default 100

config GIMBAL_VBUS_SENSE
    bool "Bus-voltage sampling is installed"
    depends on ADC
    default n

config GIMBAL_PHASE_CURRENT_SENSE
    bool "Phase-current sampling is installed"
    depends on ADC
    default y if GIMBAL_MOTOR_CURRENT_FOC
    default n

config GIMBAL_DRIVER_TEMP_SENSE
    bool "Motor-driver temperature sensing is installed"
    depends on ADC
    default n

config GIMBAL_MOS_TEMP_SENSE
    bool "MOS temperature sensing is installed"
    depends on ADC
    default n

config GIMBAL_CLOSED_LOOP_STACK_SIZE
    int "Sensor batch and closed-loop task stack bytes"
    range 2048 12288
    default 4096

config GIMBAL_PLANNER_STACK_SIZE
    int "Planner task stack bytes"
    range 768 8192
    default 1536

config GIMBAL_SUPERVISOR_STACK_SIZE
    int "Supervisor task stack bytes"
    range 768 8192
    default 1536

config GIMBAL_THERMAL_STACK_SIZE
    int "Thermal task stack bytes"
    range 512 4096
    default 1024

endmenu

endif # GIMBAL
```

## bootloader/common/Kconfig
```kconfig
menu "Boot Security Policy"

config BOOT_PRODUCTION
    bool "Production secure-boot policy"
    default n
    select BOOT_REQUIRE_SIGNATURE
    help
      Enable the fail-closed production policy for every image in the boot
      chain. The product loader must provide common/boot_security.cc with an
      audited P-256 verifier and an OTP-backed monotonic security-version
      provider. The preloader also consumes this symbol so that it cannot
      execute an unauthenticated field-upgrade loader in production.

config BOOT_MIN_SECURITY_VERSION
    int "Development minimum firmware security version"
    default 0
    range 0 2147483647
    depends on !BOOT_PRODUCTION
    help
      Development-only compile-time rollback floor. Production builds must
      read the floor from one-time-programmable or equivalently protected
      monotonic storage.

config BOOT_REQUIRE_SIGNATURE
    bool "Require ECDSA-P256 image signature"
    default n
    help
      Fail closed unless the product supplies verify_image_signature(). A
      production build selects this option automatically.

endmenu
```

## bootloader/loader/Kconfig
```kconfig
menu "Loader Configuration"

choice BOOT_MODE
    prompt "Application installation mode"
    default BOOT_MODE_AB

config BOOT_MODE_AB
    bool "Power-loss-safe swap mode (single execution slot)"
    help
      Download into upgrade, validate it, then sector-swap it with slot0 via
      a dedicated scratch erase block. Persistent phase checkpoints survive
      reset during every swap step. The previous image remains in upgrade and
      is restored automatically unless the trial application confirms itself.

config BOOT_MODE_DIRECT
    bool "Development-only direct overwrite mode"
    help
      Download directly into slot0. This uses less Flash but cannot recover an
      old application after erase or an interrupted download. Production
      builds reject this mode.

endchoice

config BOOT_MODE_STAGED_COPY
    bool
    default y if BOOT_MODE_AB
    help
      Internal compatibility name for CONFIG_BOOT_MODE_AB. The layout has one
      execution slot plus one rollback image; it is not execute-in-place A/B.

choice BOOT_DFU_TRANSPORT
    prompt "DFU recovery transport"
    default BOOT_DFU_CUSTOM if BOOT_PRODUCTION
    default BOOT_DFU_UART

config BOOT_DFU_UART
    bool "UART DFU transport"
    depends on !BOOT_PRODUCTION
    help
      Use the generated uart0 device for development recovery and DFU. This
      raw transport has no authenticated session boundary and therefore cannot
      be selected by a production loader.

config BOOT_DFU_CUSTOM
    bool "Product-provided DFU transport"
    help
      Require product/<name>/common/boot_transport.cc to register a custom
      recovery transport at POST_KERNEL level and implement
      boot::transport_shutdown(). In production, the provider must authenticate
      and authorize a session before delivering frames to the protocol layer.

endchoice

config BOOT_WATCHDOG
    bool "Require product watchdog integration"
    default y if BOOT_PRODUCTION
    help
      Require product/<name>/common/boot_watchdog.cc. The provider must
      implement watchdog_service() and watchdog_prepare_handoff(). Its timeout
      must exceed one worst-case Flash-sector operation and signature check.

config BOOT_STACK_SIZE
    int "Loader main/interrupt stack size in bytes"
    default 2048
    range 1024 8192
    help
      Shared MSP size for loader code and interrupts. Builds reject a
      loader-owned C/C++ function with a static frame larger than 768 bytes;
      final sizing still requires call-chain and interrupt-nesting analysis.

endmenu
```

## bootloader/preloader/Kconfig
```kconfig
menu "Preloader Configuration"

comment "Product identity is defined by product/<name>/layout.json"

endmenu
```

## bootloader/upgrade/Kconfig
```kconfig
menu "Upgrade App Configuration"

comment "Product identity is defined by product/<name>/layout.json"

endmenu
```

## component/attitude/Kconfig
```kconfig
menuconfig ATTITUDE_EKF
    bool "Error-state attitude EKF"
    depends on MOTION
```

## component/control/Kconfig
```kconfig
menuconfig FEEDBACK_CONTROL
    bool "Frequency-shaped feedback control"
    depends on MOTION
```

## component/foc/Kconfig
```kconfig
menuconfig FOC
    bool "FOC Motor Control"
    help
      Enable field-oriented motor modulation and control algorithms.

if FOC

config FOC_CURRENT_CONTROL
    bool "Phase-current closed-loop FOC"
    depends on DT_HAS_FOC_MOTOR_ENABLED
    default y if DT_HAS_FOC_MOTOR_ENABLED
    help
      Enable the phase-current controller and foc,motor device integration.

config FOC_VOLTAGE_CONTROL
    bool "Open-loop voltage FOC"
    help
      Enable bounded dq-voltage modulation for hardware without phase-current
      sensing. This mode does not provide a torque or current loop.

config FOC_SPEED_LOOP_HZ
    int "Speed loop frequency (Hz)"
    depends on FOC_CURRENT_CONTROL
    range 1 10000
    default 100
    help
      Speed control loop update rate.

endif # FOC
```

## component/gimbal/Kconfig
```kconfig
menuconfig GIMBAL
    bool "Three-axis gimbal control"
    help
      Enable the product-independent gimbal estimation, planning, control,
      continuous Hall and voltage-FOC components.

if GIMBAL

choice GIMBAL_MOTOR_CONTROL_MODE
    prompt "Gimbal motor control mode"
    default GIMBAL_MOTOR_VOLTAGE_FOC

config GIMBAL_MOTOR_VOLTAGE_FOC
    bool "Hall-sensored voltage FOC"
    help
      Baseline mode without phase-current sampling. This is not a torque loop.

config GIMBAL_MOTOR_CURRENT_FOC
    bool "Current FOC"
    depends on ADC
    help
      Optional mode for hardware with synchronized phase-current sampling.

endchoice

config GIMBAL_CONTROL_HZ
    int "Attitude and rate control frequency"
    range 500 2000
    default 1000

config GIMBAL_SENSOR_HZ
    int "Synchronous sensor trigger frequency"
    range 8000 32000
    default 16000
    help
      Hardware timer rate used to launch asynchronous sensor DMA. It must be
      an integer multiple of GIMBAL_CONTROL_HZ.

config GIMBAL_PLANNER_HZ
    int "Motion planner frequency"
    range 100 500
    default 200

config GIMBAL_THERMAL_HZ
    int "IMU thermal controller frequency"
    range 10 100
    default 20

config GIMBAL_SUPERVISOR_HZ
    int "Safety supervisor frequency"
    range 10 200
    default 100

config GIMBAL_VBUS_SENSE
    bool "Bus-voltage sampling is installed"
    depends on ADC
    default n

config GIMBAL_PHASE_CURRENT_SENSE
    bool "Phase-current sampling is installed"
    depends on ADC
    default y if GIMBAL_MOTOR_CURRENT_FOC
    default n

config GIMBAL_DRIVER_TEMP_SENSE
    bool "Motor-driver temperature sensing is installed"
    depends on ADC
    default n

config GIMBAL_MOS_TEMP_SENSE
    bool "MOS temperature sensing is installed"
    depends on ADC
    default n

endif
```
