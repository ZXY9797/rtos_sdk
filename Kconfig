## component/link/Kconfig
```kconfig
menuconfig LINK
	bool "Link 通信协议栈"
	default y
	depends on OSAL_HAS_THREADS
	depends on OSAL_HAS_STATIC_PERIODIC_THREADS

if LINK

config LINK_MAX_FRAME_SIZE
	int "最大帧长度 (字节)"
	range 16 1023
	default 512

config LINK_MAX_LINKS
	int "最大链路数"
	range 1 255
	default 8

config LINK_MAX_ROUTES
	int "最大路由规则数"
	range 1 1024
	default 16

config LINK_MAX_PENDING
	int "最大待确认帧数"
	range 1 1024
	default 8

config LINK_REPLAY_CACHE_SIZE
	int "Acknowledged request replay-cache entries"
	range 1 256
	default 16
	help
	  Completed acknowledged requests are retained here so a retransmission
	  replays the previous ACK without executing the command twice.

config LINK_REPLAY_RETENTION_MS
	int "Acknowledged request replay retention (ms)"
	range 100 60000
	default 10000
	help
	  Must exceed the longest sender retry horizon. Sequence reuse is accepted
	  only after this interval has elapsed.

config LINK_SECURITY
    bool "Product-provided authenticated encryption"
    default n
    help
      Compile and require app/product/<product>/common/link_security.cc.
      Enable this for selective LINK_SECURE_HANDLER commands as well as the
      global plaintext-rejection policy.

config LINK_REQUIRE_SECURE_COMMANDS
    bool "Reject all plaintext commands"
    select LINK_SECURITY
    default n
    help
      Require authenticated encryption for every locally handled command.

config LINK_PROCESS_HZ
	int "Link 处理任务频率 (Hz)"
	range 1 SYS_CLOCK_TICKS_PER_SEC
	default 1000

config LINK_PROCESS_STACK
	int "Link 处理任务栈大小 (字节)"
	range 1024 65536
	default 2048

config LINK_PROCESS_PRIO
	int "Link 处理任务优先级"
	range 0 31
	default 5

config LINK_INIT_PRIORITY
	int "Link lifecycle init priority"
	range 81 98
	default 95
	help
	  Router must start after all generated Link transport devices (currently
	  priority 80 or lower) and before the system watchdog monitor at 99. This
	  also guarantees reverse-order shutdown before those devices are deinit.

config LINK_PROCESS_RX_BUDGET
	int "Maximum received bytes per link and process cycle"
	range 16 8192
	default 1024
	help
	  Bounds one transport's work per Router cycle so malformed or continuous
	  traffic cannot starve other links, ACK timeouts, or health monitoring.

config LINK_UART_TX_TIMEOUT_MS
	int "UART link bounded transmit timeout (ms)"
	range 1 5000
	default 100
	help
	  Maximum time the dedicated Link processing task may wait for one UART
	  frame to finish. Size this from baud rate and LINK_MAX_FRAME_SIZE.

endif
```

## component/motion/Kconfig
```kconfig
menuconfig MOTION
    bool "Three-axis motion model"
    help
      Enable fixed-size spatial math, non-orthogonal kinematics, rigid-body
      feedforward dynamics and bounded trajectory planning.
```

## component/position_sensor/Kconfig
```kconfig
menuconfig POSITION_SENSOR
    bool "Continuous Hall angle sensor"
    depends on MOTION
```

## component/safety/Kconfig
```kconfig
menuconfig SAFETY_SUPERVISOR
    bool "Control safety supervisor"
    depends on MOTION
```

## component/thermal/Kconfig
```kconfig
menuconfig THERMAL_CONTROL
    bool "Closed-loop thermal control"
    depends on MOTION
```

## embedded/drivers/Kconfig
```kconfig
menu "Device Drivers"

config STM32_DIRECT_REGISTER_DRIVERS
	bool "Experimental STM32 direct-register peripheral backends"
	depends on SOC_FAMILY_STM32
	default n
	help
	  Enable the STM32 UART, SPI, PWM, I2C and Flash direct-register
	  backends for board bring-up only. These backends still require a
	  product clock/reset owner and hardware validation. Product builds
	  should leave this disabled until those contracts are supplied.

# zephyr-keep-sorted-start
source "embedded/drivers/cache/Kconfig"
source "embedded/drivers/can/Kconfig"
source "embedded/drivers/clock_control/Kconfig"
source "embedded/drivers/dma/Kconfig"
source "embedded/drivers/flash/Kconfig"
source "embedded/drivers/gpio/Kconfig"
source "embedded/drivers/i2c/Kconfig"
source "embedded/drivers/interrupt_controller/Kconfig"
source "embedded/drivers/imu/Kconfig"
source "embedded/drivers/log/Kconfig"
source "embedded/drivers/adc/Kconfig"
source "embedded/drivers/pinctrl/Kconfig"
source "embedded/drivers/pwm/Kconfig"
source "embedded/drivers/spi/Kconfig"
source "embedded/drivers/uart/Kconfig"
# zephyr-keep-sorted-stop

endmenu
```

## embedded/drivers/can/Kconfig
```kconfig
menuconfig CAN
	bool "CAN drivers"
	help
	  Include CAN drivers in system config

rsource "Kconfig.stm32"
rsource "Kconfig.gd32"

if CAN

config CAN_INIT_PRIORITY
	int "CAN init priority"
	range 0 999
	default KERNEL_INIT_PRIORITY_DEFAULT
	help
	  CAN driver device initialization priority.

endif # CAN
```

## embedded/drivers/can/Kconfig.gd32
```kconfig
config CAN_GD32
	bool "CAN driver for GD32"
	select CAN
	default y if SOC_SERIES_GD32F50X
	depends on SOC_SERIES_GD32F50X && DT_HAS_GD_GD32_CAN_ENABLED
	help
	  Enable CAN driver for GD32F50x family.
```

## embedded/drivers/can/Kconfig.stm32
```kconfig
config CAN_STM32
	bool "CAN (FDCAN) driver for STM32"
	select CAN
	select USE_STM32_HAL_FDCAN
	default y if SOC_FAMILY_STM32
	depends on SOC_FAMILY_STM32
	depends on DT_HAS_ST_STM32_FDCAN_ENABLED || DT_HAS_ST_STM32H7_FDCAN_ENABLED
	help
	  Enable CAN driver for STM32 family using HAL FDCAN.
```

## embedded/drivers/dma/Kconfig.gd32
```kconfig
config DMA_GD32
	bool "GD32 DMA driver"
	select DMA
	depends on SOC_SERIES_GD32F50X && DT_HAS_GD_GD32_DMA_ENABLED
	default y
	help
	  Enable DMA driver for GD32F50x series using DMAMUX.
```

## embedded/drivers/flash/Kconfig.gd32
```kconfig
config FLASH_GD32
	bool "Flash driver for GD32"
	select FLASH
	default y
	depends on SOC_FAMILY_GD && DT_HAS_SOC_NV_FLASH_ENABLED
	help
	  Enable Flash driver for GD32 family using FMC.
```

## embedded/drivers/flash/Kconfig.goodix
```kconfig
config FLASH_GOODIX
	bool "Flash driver for Goodix GR5525"
	select FLASH
	default y
	depends on SOC_SERIES_GR5525X && DT_HAS_SOC_NV_FLASH_ENABLED
	help
	  Enable Flash driver for Goodix GR5525 external flash.
```
