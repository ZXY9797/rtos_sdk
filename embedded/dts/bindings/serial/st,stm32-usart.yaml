## embedded/dts/bindings/serial/st,stm32-usart.yaml
```yaml
description: STM32 USART

compatible: "st,stm32-usart"

include: st,stm32-uart-base.yaml

cxx-driver:
  adapter:
    header: device_adapters/uart_dt.h
    macro: HAL_UART_DT_ADAPT
  type-name: Uart
  init: true
  interrupts:
    - name: global
      method: isr_global
      uses-osal: true
      enable-on-init: true
  readiness: device-base
  device-base: true
  init-level: post-kernel
  init-priority: 25
```

## embedded/dts/bindings/spi/goodix,gr5525-spi.yaml
```yaml
description: Goodix GR5525 SPI (DesignWare SSI compatible)

compatible: "goodix,gr5525-spi"

include: [spi-controller.yaml, base.yaml]

cxx-driver:
  adapter:
    header: device_adapters/spi_dt.h
    macro: HAL_SPI_DT_ADAPT
  type-name: Spi
  init: true
  readiness: device-base
  device-base: true
  init-level: pre-kernel-2
  init-priority: 25

properties:
  reg:
    type: array
    required: true

  interrupts:
    type: array
    required: true

  spi-max-frequency:
    type: int
    default: 1000000

  label:
    type: string
    required: true
```

## embedded/dts/bindings/spi/st,stm32-spi.yaml
```yaml
# Copyright (c) 2018, I-SENSE group of ICCS
# SPDX-License-Identifier: Apache-2.0

description: STM32 SPI controller

compatible: "st,stm32-spi"

include: st,stm32-spi-common.yaml

cxx-driver:
  adapter:
    header: device_adapters/spi_dt.h
    macro: HAL_SPI_DT_ADAPT
  type-name: Spi
  init: true
  interrupts:
    - name: global
      method: isr_global
      uses-osal: true
      enable-on-init: true
  readiness: device-base
  device-base: true
  init-level: pre-kernel-2
  init-priority: 25
```

## embedded/osal/Kconfig
```kconfig
menu "RTOS Selection"

choice RTOS_TYPE
    prompt "Select RTOS"
    default RTOS_RT_THREAD

config RTOS_BAREMETAL
    bool "Baremetal OSAL"

config RTOS_RT_THREAD
    bool "RT-Thread Nano"

config RTOS_FREERTOS
    bool "FreeRTOS"

endchoice

config OSAL_HAS_THREADS
	bool
	default n if RTOS_BAREMETAL
	default y
	help
	  Internal capability flag. Selectors that require actual schedulable
	  threads must depend on this instead of assuming all OSAL backends provide
	  the same runtime facilities.

config OSAL_HAS_STATIC_THREADS
    bool
    default n if RTOS_BAREMETAL
    default y
    help
      Backend can create a thread from caller-owned TCB and stack storage.

config OSAL_HAS_STATIC_PERIODIC_THREADS
    bool
    default n if RTOS_BAREMETAL
    default y
    help
      Backend can create PeriodicThread without task or semaphore heap use.

config OSAL_HAS_MESSAGE_QUEUES
    bool
    default n if RTOS_BAREMETAL
    default y

config OSAL_HAS_EVENT_GROUPS
    bool
    default n if RTOS_BAREMETAL
    default y

config OSAL_HAS_SOFT_TIMERS
    bool
    default n if RTOS_BAREMETAL
    default y

config OSAL_HAS_STREAM_BUFFERS
    bool
    default y
    help
      All backends implement the bounded single-producer/single-consumer byte
      stream contract, including the baremetal backend.

config OSAL_BAREMETAL_HEAP_SIZE
    int "Baremetal OSAL heap size"
    default 4096
    range 0 65536
    depends on RTOS_BAREMETAL
    help
      Static bytes reserved for the baremetal allocator. Set this to zero in
      firmware that forbids dynamic allocation; rtos_malloc() will then fail
      deterministically without reserving a heap.

config FREERTOS_HEAP_SIZE
    int "FreeRTOS heap size"
    default 32768
    range 4096 262144
    depends on RTOS_FREERTOS
    help
      Bytes reserved by heap_4 for explicitly dynamic RTOS objects. Products
      should size this from measured peak usage; static queues, stream buffers,
      the main task, idle task, and timer task do not consume this heap.

config RTTHREAD_HEAP_SIZE
    int "RT-Thread heap size"
    default 32768
    range 4096 262144
    depends on RTOS_RT_THREAD
    help
      Bytes reserved by the RT-Thread system heap. Products must size this
      from measured peak use, including dynamic kernel objects.

config OSAL_TICKLESS_IDLE
    bool "Product-provided tickless idle"
    default n
    depends on RTOS_FREERTOS
    help
      Enable FreeRTOS tickless idle only when the product provides
      common/osal_low_power.cc with a validated vPortSuppressTicksAndSleep().
      The provider owns clock switching, wake sources, elapsed-tick accounting,
      and peripheral sleep constraints.

endmenu
```

## embedded/system/Kconfig
```kconfig
menu "System Reliability"

config APP_PRODUCTION
    bool "Production application policy"
    depends on OSAL_HAS_THREADS
    depends on OSAL_HAS_STATIC_THREADS
    default n
    select APP_WATCHDOG
    select FAULT_NOINIT_BACKEND
    help
      Fail-closed application profile. Enabling it requires a product hardware
      watchdog provider and persistent fatal diagnostics. Product release jobs
      should enable this symbol in a release-only configuration fragment.

config APP_WATCHDOG
    bool "Application health watchdog"
    depends on OSAL_HAS_THREADS
    depends on OSAL_HAS_STATIC_THREADS
    default n
    help
      Start a hardware watchdog and feed it only from the health-monitor task.
      The product must provide common/app_watchdog.cc. A scheduler deadlock or
      an expired registered client therefore stops feeding the hardware.

config APP_WATCHDOG_TIMEOUT_MS
    int "Hardware watchdog timeout in milliseconds"
    depends on APP_WATCHDOG
    default 5000
    range 500 60000

config APP_WATCHDOG_CHECK_MS
    int "Health-monitor period in milliseconds"
    depends on APP_WATCHDOG
    default 100
    range 10 1000

config APP_WATCHDOG_STACK_SIZE
    int "Health-monitor stack size in bytes"
    depends on APP_WATCHDOG
    default 768
    range 512 4096

endmenu
```
