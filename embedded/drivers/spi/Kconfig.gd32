## embedded/drivers/spi/Kconfig.gd32
```kconfig
config SPI_GD32
	bool "GD32 SPI driver"
	select SPI
	depends on SOC_SERIES_GD32F50X
	default y
	help
	  Enable SPI driver for GD32F50x series with DMA support.
```

## embedded/drivers/timer/Kconfig
```kconfig
if SYS_CLOCK_EXISTS

menu "Timer drivers"

config TIMER_HAS_64BIT_CYCLE_COUNTER
	bool
	help
	  When this option is true, the k_cycle_get_64() call is
	  available to provide values from a 64-bit cycle counter.

config TIMER_READS_ITS_FREQUENCY_AT_RUNTIME
	bool "Timer queries its hardware to find its frequency at runtime"
	help
	  The drivers select this option automatically when needed. Do not modify
	  this unless you have a very good reason for it.

config SYSTEM_CLOCK_INIT_PRIORITY
	int "System clock driver initialization priority"
	default 0
	help
	  This options can be used to set a specific initialization priority
	  value for the system clock driver. As driver initialization  might need
	  the clock to be running already, you should let the default value as it
	  is (0).

# Hidden option to be selected by individual SoC.
config TICKLESS_CAPABLE
	bool
	help
	  Timer drivers should select this flag if they are capable of
	  supporting tickless operation.  That is, a call to
	  sys_clock_set_timeout() with a number of ticks greater than
	  one should be expected not to produce a call to
	  sys_clock_announce() (really, not to produce an interrupt at
	  all) until the specified expiration.

config SYSTEM_TIMER_HAS_DISABLE_SUPPORT
	bool
	help
	  This option should be selected by drivers implementing support for
	  sys_clock_disable() API.

config SYSTEM_CLOCK_LOCK_FREE_COUNT
	bool
	help
	  This option should be selected by drivers implementing a lock free
	  cycle count accessor. This is needed for instrumenting spin lock
	  hold times.

rsource "Kconfig.cortex_m_systick"
rsource "Kconfig.stm32_lptim"

endmenu

endif
```

## embedded/drivers/timer/Kconfig.cortex_m_systick
```kconfig
config CORTEX_M_SYSTICK
	bool "Cortex-M SYSTICK timer"
	depends on CPU_CORTEX_M_HAS_SYSTICK
	default y
	depends on DT_HAS_ARM_ARMV6M_SYSTICK_ENABLED || \
		   DT_HAS_ARM_ARMV7M_SYSTICK_ENABLED || \
		   DT_HAS_ARM_ARMV8M_SYSTICK_ENABLED || \
		   DT_HAS_ARM_ARMV8_1M_SYSTICK_ENABLED
	select TICKLESS_CAPABLE
	select SYSTEM_TIMER_HAS_DISABLE_SUPPORT
	select CORTEX_M_SYSTICK_INSTALL_ISR
	help
	  This module implements a kernel device driver for the Cortex-M processor
	  SYSTICK timer and provides the standard "system clock driver" interfaces.
```

## embedded/drivers/uart/Kconfig
```kconfig
menuconfig UART
	bool "UART drivers"
	help
	  Include UART drivers in system config

rsource "Kconfig.stm32"
rsource "Kconfig.gd32"
rsource "Kconfig.gr5525"

if UART

config UART_INIT_PRIORITY
	int "UART init priority"
	default KERNEL_INIT_PRIORITY_DEFAULT
	help
	  UART driver device initialization priority.

endif # UART
```

## embedded/dts/bindings/base/msdk,memory-region.yaml
```yaml
# Copyright (c) 2021, CSIRO
# SPDX-License-Identifier: Apache-2.0

description: Compatible for devices resulting in linker memory regions

compatible: "msdk,memory-region"

include: [base.yaml, "msdk,memory-common.yaml"]

properties:
  msdk,memory-region:
    required: true
```

## embedded/dts/bindings/base/msdk,mempool.yaml
```yaml
description: Compatible for devices resulting in linker memory regions

compatible: "msdk,mempool"

include: [base.yaml]

properties:
  section-name:
    type: string
    required: true

  attr:
    type: int
    required: true

  size:
    type: int
    required: true
```

## embedded/dts/bindings/base/rtos_sdk,memory-common.yaml
```yaml
# Copyright (c) 2023, Carlo Caione <ccaione@baylibre.com>
# SPDX-License-Identifier: Apache-2.0

include: [base.yaml]

properties:
  rtos_sdk,memory-region:
    type: string
    description: |
      Signify that this node should result in a dedicated linker script
      memory region in the final executable. The region address and size
      is taken from the <reg> property, while the name is the value of
      this property.

  rtos_sdk,memory-region-flags:
    type: string
    description: |
      Set attributes such as read-only or executable for the linker script
      memory region. The string set here will be specified in parentheses
      after the area name in the linker script.

  rtos_sdk,memory-region-mpu:
    type: string
    deprecated: true
    description: |
      Signify that this node should result in a dedicated MPU region.
      Deprecated in favor of 'rtos_sdk,memory-attr'.

  rtos_sdk,memory-attr:
    type: int
    description: |
      Attribute or set of attributes (bitmask) for the memory region. See
      'include/zephyr/dt-bindings/memory-attr/memory-attr.h' for a
      comprehensive list with description of possible values.

  reg:
    required: true
```

## embedded/dts/bindings/base/rtos_sdk,mempool.yaml
```yaml
description: Compatible for devices resulting in linker memory regions

compatible: "rtos_sdk,mempool"

include: [base.yaml]

properties:
  section-name:
    type: string
    required: true

  attr:
    type: int
    required: true

  size:
    type: int
    required: true
```

## embedded/dts/bindings/cpu/arm,cortex-m7.yaml
```yaml
# Copyright (c) 2018 Nordic Semiconductor ASA
# SPDX-License-Identifier: Apache-2.0

description: ARM Cortex-M7 CPU

compatible: "arm,cortex-m7"

include: arm,cortex-m.yaml

properties:
  i-cache-enabled:
    type: boolean
    description: |
      Enable instruction cache.

  d-cache-enabled:
    type: boolean
    description: |
      Enable data cache.
```

## embedded/dts/bindings/dma/gd,gd32-dma.yaml
```yaml
description: GD32 DMA controller with DMAMUX

compatible: "gd,gd32-dma"

include: [dma-controller.yaml, base.yaml]

properties:
  reg:
    type: array
    required: true

  interrupts:
    type: array
    required: true

  label:
    type: string
    required: true

  dma-channels:
    type: int
    required: true
    description: Number of DMA channels

  mux-channels:
    type: int
    required: true
    description: Number of DMAMUX channels

dma-cells:
  - channel
  - request-id
```

## embedded/dts/bindings/gpio/gd,gd32-gpio.yaml
```yaml
description: GD32 GPIO controller

compatible: "gd,gd32-gpio"

include: [gpio-controller.yaml, base.yaml]

properties:
  reg:
    type: array
    required: true

  interrupts:
    type: array
    required: true

  label:
    type: string
    required: true

  ngpios:
    type: int
    required: true

gpio-cells:
  - pin
  - flags
```

## embedded/dts/bindings/gpio/goodix,gr5525-gpio.yaml
```yaml
description: Goodix GR5525 GPIO controller

compatible: "goodix,gr5525-gpio"

include: [gpio-controller.yaml, base.yaml]

properties:
  reg:
    type: array
    required: true

  interrupts:
    type: array
    required: true

  label:
    type: string
    required: true

  ngpios:
    type: int
    required: true

gpio-cells:
  - pin
  - flags
```

## embedded/dts/bindings/memory-controllers/rtos_sdk,memory-region.yaml
```yaml
# Copyright (c) 2024 RTOS SDK Contributors
# SPDX-License-Identifier: Apache-2.0

description: |
  Base binding for memory regions with a symbolic name.
  Nodes using this binding describe a memory region that can be
  referenced by name in the application (e.g. SRAM0, DTCM, ITCM).

compatible: "rtos_sdk,memory-region"

include: base.yaml

properties:
  reg:
    required: true

  rtos_sdk,memory-region:
    type: string
    required: true
    description: |
      Symbolic name for this memory region (e.g. "SRAM0", "DTCM").
```

## embedded/dts/bindings/pinctrl/gd,gd32-pinctrl.yaml
```yaml
description: GD32 引脚控制器

compatible: "gd,gd32-pinctrl"

properties:
  label:
    type: string

child-binding:
  description: GD32 引脚配置状态

  properties:
    pinmux:
      type: array
      required: true
      description: 由 GD32_PINMUX_* 宏展开的通用 pinctrl MMIO 操作流。
```

## embedded/dts/bindings/serial/st,stm32-uart.yaml
```yaml
description: STM32 UART

compatible: "st,stm32-uart"

include: st,stm32-uart-base.yaml

cxx-driver:
  template: Uart
  header: drivers/uart.h
  args:
    - node-reg
    - irq
```

## embedded/dts/bindings/sysinfo/st,stm32h743-sysinfo.yaml
```yaml
description: |
  stm32h743 sysinfo

compatible: "st,stm32h743-sysinfo"

include: sysinfo.yaml
```

## embedded/dts/bindings/sysinfo/sysinfo.yaml
```yaml
include: base.yaml

properties:
  clock-frequency:
    type: int
    description: Clock frequency information for UART operation
```

## embedded/modules/cmsis/Kconfig
```kconfig
config HAS_CMSIS_CORE
	bool
	select HAS_CMSIS_CORE_M if CPU_CORTEX_M

if HAS_CMSIS_CORE

config HAS_CMSIS_CORE_M
	bool

config CMSIS_M_CHECK_DEVICE_DEFINES
	bool "Check device defines"
	depends on HAS_CMSIS_CORE_M
	help
	  This options enables the validation of CMSIS configuration flags.

config CMSIS_CORE_HAS_SYSTEM_CORE_CLOCK
	bool
	help
	  Enable this option if CMSIS SystemCoreClock symbols is available.

endif
```

## embedded/soc/Kconfig
```kconfig
menu "SOC Configure"

config SOC
	string
	help
	  SoC name. The value of this setting must be defined by the selected
	  SoC for hw model v2.

config SOC_SERIES
	string
	help
	  SoC series. The value of this setting must be defined by the selected
	  SoC if the SoC belongs to a common series.

config SOC_FAMILY
	string
	help
	  SoC family. The value of this setting must be defined by the selected
	  SoC if the SoC belongs to a SoC family. Usually a SoC family also
	  indicates the vendor of the SoC.

config SOC_PART_NUMBER
	string
	help
	  This string holds the full part number of the SoC. It is a hidden option
	  that you should not set directly. The part number selection choice defines
	  the default value for this string.

orsource "*/Kconfig"

endmenu
```

## embedded/soc/gd/Kconfig
```kconfig
rsource "Kconfig.soc"

config SOC_SERIES_GD32F50X
	bool "GigaDevice GD32F50x series"
	select ARM
	select SOC_GD32F50X
	select SOC_FAMILY_GD
	help
	  GigaDevice GD32F50x series SoC

if SOC_SERIES_GD32F50X

rsource "Kconfig.defconfig"

rsource "gd32f50x/Kconfig"

config SOC_SERIES
	default "gd32f50x"

endif # SOC_SERIES_GD32F50X
```

## embedded/soc/gd/Kconfig.defconfig
```kconfig
if SOC_FAMILY_GD

# Source series Kconfig files first, so SoCs
# can override the defaults given here
rsource "*/Kconfig.defconfig"

config SYS_CLOCK_HW_CYCLES_PER_SEC
	default 200000000

config SYS_CLOCK_TICKS_PER_SEC
	default 1000

endif # SOC_FAMILY_GD
```

## embedded/soc/gd/Kconfig.soc
```kconfig
# GigaDevice SoC configuration

config SOC_FAMILY_GD
	bool

config SOC_VENDOR
	string
	default "gd" if SOC_SERIES_GD32F50X

config SOC_FAMILY
	default "gd" if SOC_FAMILY_GD
```

## embedded/soc/gd/gd32f50x/Kconfig
```kconfig
# GigaDevice GD32F50x series SoC configuration

config SOC_GD32F50X
    bool
    select ARM
    select CPU_CORTEX_M4
    select CPU_HAS_FPU

config SOC
    string
    default "gd32f50x"

config SOC_NAME
    string
    default "GD32F50X"
```

## embedded/soc/gd/gd32f50x/Kconfig.defconfig
```kconfig
# GigaDevice GD32F50x series SoC defconfig

if SOC_SERIES_GD32F50X

config ROM_START_OFFSET
    hex
    default 0x0

config SYS_CLOCK_HW_CYCLES_PER_SEC
    default 200000000

config NUM_IRQS
    default 96

endif # SOC_SERIES_GD32F50X
```
