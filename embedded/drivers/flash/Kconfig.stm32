## embedded/dts/bindings/pwm/gd,gd32-timer.yaml
```yaml
description: GD32 TIMER (PWM) controller

compatible: "gd,gd32-timer"

include: [pwm-controller.yaml, base.yaml, pinctrl-device.yaml]

cxx-driver:
  adapter:
    header: device_adapters/pwm_dt.h
    macro: HAL_GD32_PWM_DT_ADAPT
  type-name: Pwm
  init: true
  interrupts:
    - name: update
      method: isr_update
      uses-osal: true
  readiness: is-initialized
  init-level: pre-kernel-2
  init-priority: 25

properties:
  reg:
    type: array
    required: true

  interrupts:
    type: array
    required: true

  label:
    type: string
    required: true

  channel:
    type: int
    required: true
    description: PWM channel index (0=Ch1, 1=Ch2, 2=Ch3, 3=Ch4)

  prescaler:
    type: int
    default: 0
    description: PWM timer prescaler value

  period:
    type: int
    default: 0
    description: PWM timer period value

  "#pwm-cells":
    const: 3

pwm-cells:
  - channel
  - period
  - flags
```

## embedded/dts/bindings/serial/goodix,gr5525-uart.yaml
```yaml
description: Goodix GR5525 UART

compatible: "goodix,gr5525-uart"

include: [uart-controller.yaml, base.yaml]

cxx-driver:
  adapter:
    header: device_adapters/uart_dt.h
    macro: HAL_UART_DT_ADAPT
  type-name: Uart
  init: true
  interrupts:
    - name: global
      method: isr_global
      uses-osal: true
  readiness: device-base
  device-base: true
  init-level: post-kernel
  init-priority: 25

properties:
  reg:
    type: array
    required: true

  interrupts:
    type: array
    required: true

  current-speed:
    type: int
    default: 115200

  label:
    type: string
    required: true
```

## embedded/dts/bindings/serial/st,stm32-lpuart.yaml
```yaml
description: STM32 LPUART

compatible: "st,stm32-lpuart"

include: st,stm32-uart-base.yaml

cxx-driver:
  adapter:
    header: device_adapters/uart_dt.h
    macro: HAL_UART_DT_ADAPT
  type-name: Uart
  init: true
  interrupts:
    - name: global
      method: isr_global
      uses-osal: true
  readiness: device-base
  device-base: true
  init-level: post-kernel
  init-priority: 25
```
