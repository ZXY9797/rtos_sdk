## embedded/drivers/flash/Kconfig.stm32
```kconfig
config FLASH_STM32
	bool "Flash driver for STM32"
	select FLASH
	default y
	depends on SOC_FAMILY_STM32
	depends on STM32_DIRECT_REGISTER_DRIVERS
	depends on DT_HAS_SOC_NV_FLASH_ENABLED || DT_HAS_ST_STM32_NV_FLASH_ENABLED
	help
	  Enable Flash driver for STM32 family using HAL.
```

## embedded/drivers/i2c/Kconfig.stm32
```kconfig
config I2C_STM32
	bool "I2C driver for STM32"
	select I2C
	default y
	depends on SOC_FAMILY_STM32
	depends on STM32_DIRECT_REGISTER_DRIVERS
	depends on DT_HAS_ST_STM32_I2C_V2_ENABLED
	help
	  Enable I2C driver for STM32 family using HAL.
```

## embedded/drivers/imu/Kconfig
```kconfig
menuconfig IMU_ICM40609D
	bool "ICM40609D 6-axis IMU driver"
	depends on DT_HAS_INVENSENSE_ICM40609D_ENABLED
	help
	  Enable InvenSense ICM40609D 6-axis IMU (SPI interface).
```

## embedded/drivers/log/Kconfig
```kconfig
menu "Logging"

config LOG_ASYNC
	bool "Asynchronous log dispatcher"
	depends on OSAL_HAS_THREADS
	default y
	help
	  Format in the producer and enqueue into a bounded static queue. A single
	  consumer owns all backend writes. Producers never wait for UART output;
	  records are counted as dropped when the queue is full or called from ISR.

config LOG_QUEUE_DEPTH
	int "Asynchronous log queue depth"
	depends on LOG_ASYNC
	range 2 64
	default 8

config LOG_THREAD_STACK_SIZE
	int "Log consumer stack size in bytes"
	depends on LOG_ASYNC
	range 512 4096
	default 768

config LOG_BACKEND_TIMEOUT_MS
	int "Per-record backend timeout in milliseconds"
	range 1 1000
	default 20
	help
	  Total timeout budget for a UART record including the line ending.

endmenu
```

## embedded/drivers/pwm/Kconfig
```kconfig
menuconfig PWM
	bool "PWM drivers"
	help
	  Include PWM drivers in system config

rsource "Kconfig.stm32"
rsource "Kconfig.gd32"

if PWM

config PWM_INIT_PRIORITY
	int "PWM init priority"
	range 0 999
	default KERNEL_INIT_PRIORITY_DEFAULT
	help
	  PWM driver device initialization priority.

endif # PWM
```

## embedded/drivers/pwm/Kconfig.stm32
```kconfig
config PWM_STM32
	bool "PWM driver for STM32"
	select PWM
	default y
	depends on SOC_FAMILY_STM32
	depends on STM32_DIRECT_REGISTER_DRIVERS
	depends on DT_HAS_ST_STM32_PWM_ENABLED
	help
	  Enable PWM driver for STM32 family using HAL TIM.
```

## embedded/drivers/spi/Kconfig.gr5525
```kconfig
config SPI_GR5525
    bool "GR5525 SPI driver"
    select SPI
    depends on SOC_SERIES_GR5525X && DT_HAS_GOODIX_GR5525_SPI_ENABLED
    default y
    help
      Enable GR5525 SPI driver.
```

## embedded/drivers/spi/Kconfig.stm32
```kconfig
config SPI_STM32
	bool "SPI driver for STM32"
	select SPI
	default y
	depends on SOC_FAMILY_STM32
	depends on STM32_DIRECT_REGISTER_DRIVERS
	depends on DT_HAS_ST_STM32_SPI_ENABLED || DT_HAS_ST_STM32H7_SPI_ENABLED
	help
	  Enable SPI driver for STM32 family using HAL.
```

## embedded/drivers/uart/Kconfig.gd32
```kconfig
config UART_GD32
	bool "GD32 UART driver"
	select UART
	depends on SOC_SERIES_GD32F50X && DT_HAS_GD_GD32_USART_ENABLED
	default y
	help
	  Enable GD32 UART driver.
```

## embedded/drivers/uart/Kconfig.gr5525
```kconfig
config UART_GR5525
    bool "GR5525 UART driver"
    select UART
    depends on SOC_SERIES_GR5525X && DT_HAS_GOODIX_GR5525_UART_ENABLED
    default y
    help
      Enable GR5525 UART driver.
```

## embedded/drivers/uart/Kconfig.stm32
```kconfig
config UART_STM32
	bool "UART driver for STM32"
	select UART
	default y
	depends on SOC_FAMILY_ST
	depends on DT_HAS_ST_STM32_UART_ENABLED || DT_HAS_ST_STM32_USART_ENABLED || DT_HAS_ST_STM32_LPUART_ENABLED
	help
	  Enable UART driver for STM32 family using HAL.
```

## embedded/dts/bindings/adc/gd,gd32-adc.yaml
```yaml
description: GD32 ADC controller

compatible: "gd,gd32-adc"

include: [adc-controller.yaml, base.yaml, pinctrl-device.yaml]

cxx-driver:
  adapter:
    header: device_adapters/adc_dt.h
    macro: HAL_ADC_DT_ADAPT
  type-name: Adc
  init: true
  readiness: is-initialized
  init-level: pre-kernel-2
  init-priority: 30

properties:
  reg:
    type: array
    required: true

  interrupts:
    type: array
    required: true

  resolution:
    type: int
    default: 12
    enum: [6, 8, 10, 12]

  label:
    type: string
    required: true
```

## embedded/dts/bindings/ble/goodix,gr5525-ble.yaml
```yaml
description: Goodix GR5525 BLE controller

compatible: "goodix,gr5525-ble"

include: base.yaml

properties:
  device-name:
    type: string
    default: "BLE"
    description: BLE device name advertised

  adv-interval-min:
    type: int
    default: 48
    description: Minimum advertising interval in 0.625ms units (48 = 30ms)

  adv-interval-max:
    type: int
    default: 80
    description: Maximum advertising interval in 0.625ms units (80 = 50ms)

  conn-interval-min:
    type: int
    default: 320
    description: Minimum connection interval in 1.25ms units (320 = 400ms)

  conn-interval-max:
    type: int
    default: 520
    description: Maximum connection interval in 1.25ms units (520 = 650ms)

  slave-latency:
    type: int
    default: 0
    description: Peripheral slave latency (number of connection events)

  sup-timeout:
    type: int
    default: 400
    description: Supervision timeout in 10ms units (400 = 4s)

  security-level:
    type: int
    default: 2
    description: >
      Security level: 0=None, 1=Open, 2=Mitm, 3=SecureConn

  bonding:
    type: int
    default: 1
    description: Enable bonding (0=disabled, 1=enabled)

cxx-driver:
  adapter:
    header: device_adapters/ble_dt.h
    macro: HAL_BLE_DT_ADAPT
  type-name: ble::BleDevice
  init: true
  init-level: application
  init-priority: 80
  readiness: is-initialized
```

## embedded/dts/bindings/can/can-fd-controller.yaml
```yaml
# Common fields for CAN FD controllers

include: can-controller.yaml

properties:
  bus-speed-data:
    type: int
    deprecated: true
    description: |
      Deprecated. This property has been renamed to bitrate-data.

      Initial data phase bitrate in bit/s.  If this is unset, the initial data phase bitrate is set
      to CONFIG_CAN_DEFAULT_BITRATE_DATA.
  bitrate-data:
    type: int
    description: |
      Initial data phase bitrate in bit/s.  If this is unset, the initial data phase bitrate is set
      to CONFIG_CAN_DEFAULT_BITRATE_DATA.
  data-prescaler:
    type: int
    description: Data phase clock prescaler.
  data-time-seg1:
    type: int
    description: Data phase time segment 1 in time quanta.
  data-time-seg2:
    type: int
    description: Data phase time segment 2 in time quanta.
  data-sjw:
    type: int
    description: Data phase synchronization jump width in time quanta.
  sample-point-data:
    type: int
    description: |
      Initial data phase sample point in per mille (e.g. 875 equals 87.5%).

      If this is unset (or if it is set to 0), the initial sample point will default to 75.0% for
      bitrates over 800 kbit/s, 80.0% for bitrates over 500 kbit/s, and 87.5% for all other
      bitrates.
```

## embedded/dts/bindings/can/gd,gd32-can.yaml
```yaml
description: GD32 CAN controller

compatible: "gd,gd32-can"

include: [can-controller.yaml, base.yaml, pinctrl-device.yaml]

cxx-driver:
  adapter:
    header: device_adapters/can_dt.h
    macro: HAL_CAN_DT_ADAPT
  type-name: CanDriver
  init: true
  readiness: is-initialized
  init-level: pre-kernel-2
  init-priority: 25

properties:
  reg:
    type: array
    required: true

  port:
    type: int
    required: true
    description: Zero-based GD32 CAN controller index

  interrupts:
    type: array
    required: true

  pinctrl-0:
    required: true

  pinctrl-names:
    required: true

  bitrate:
    type: int
    default: 500000

  label:
    type: string
    required: true
```

## embedded/dts/bindings/can/st,stm32h7-fdcan.yaml
```yaml
description: STM32H7 series FDCAN CAN FD controller

compatible: "st,stm32h7-fdcan"

include: ["bosch,m_can-base.yaml", "pinctrl-device.yaml"]

cxx-driver:
  adapter:
    header: device_adapters/can_dt.h
    macro: HAL_CAN_DT_ADAPT
  type-name: CanDriver
  init: true
  readiness: is-initialized
  init-level: pre-kernel-2
  init-priority: 25

properties:
  port:
    type: int
    required: true
    description: Zero-based STM32 FDCAN controller index

  clocks:
    required: true

  reg:
    required: true

  interrupts:
    required: true

  interrupt-names:
    required: true

  pinctrl-0:
    required: true

  pinctrl-names:
    required: true

  clk-divider:
    type: int
    enum:
      - 1
    description: |
      Only the reset divider of 1 is supported. Other shared FDCAN CCU
      dividers are rejected instead of being silently ignored.
```

## embedded/dts/bindings/foc/foc,motor.yaml
```yaml
description: FOC Motor controller (composite device)

compatible: "foc,motor"

include: base.yaml

properties:
  pwm-dev:
    type: phandle
    required: true
    description: PWM timer device reference

  adc-dev:
    type: phandle
    required: true
    description: ADC device reference for current sensing

  pwm-ch-u:
    type: int
    required: true
    description: U-phase PWM channel index (0=Ch1, 1=Ch2, 2=Ch3, 3=Ch4)

  pwm-ch-v:
    type: int
    required: true
    description: V-phase PWM channel index

  pwm-ch-w:
    type: int
    required: true
    description: W-phase PWM channel index

  # 电机物理参数 (工程单位, 整数)
  rs-milliohm:
    type: int
    required: true
    description: Stator resistance in milliohms

  ld-microhenry:
    type: int
    required: true
    description: D-axis inductance in microhenries

  lq-microhenry:
    type: int
    required: true
    description: Q-axis inductance in microhenries

  flux-milliweber:
    type: int
    required: true
    description: Flux linkage in milliwebers

  pole-pairs:
    type: int
    required: true
    description: Motor pole pairs

  # FOC 限制参数
  max-current-ma:
    type: int
    required: true
    description: Maximum phase current in milliamps

  max-voltage-mv:
    type: int
    required: true
    description: Maximum bus voltage in millivolts

  # FOC 控制参数
  pwm-frequency:
    type: int
    required: true
    description: PWM switching frequency in Hz

  current-bandwidth:
    type: int
    required: true
    description: Current loop bandwidth in Hz

  timer-clock-hz:
    type: int
    required: true
    description: Timer input clock before the PWM prescaler

  pwm-prescaler:
    type: int
    required: true
    description: PWM timer prescaler register value

  dead-time-ns:
    type: int
    required: true
    description: Complementary PWM dead time in nanoseconds

  adc-resolution-bits:
    type: int
    required: true

  current-u-channel:
    type: int
    required: true

  current-w-channel:
    type: int
    required: true

  vbus-channel:
    type: int
    required: true

  adc-trigger-source:
    type: int
    required: true

  adc-reference-mv:
    type: int
    required: true

  current-zero-code:
    type: int
    required: true

  current-sense-uv-per-amp:
    type: int
    required: true

  vbus-divider-milli:
    type: int
    required: true

  # 模式选择
  sensor-mode:
    type: int
    required: true
    description: >
      Sensor mode: 0=Sensorless, 1=Hall, 2=OpenLoop, 3=Encoder

  control-mode:
    type: int
    required: true
    description: >
      Control mode: 0=Torque, 1=Speed, 2=Duty, 3=Position

cxx-driver:
  adapter:
    header: device_adapters/foc_motor_dt.h
    macro: HAL_FOC_MOTOR_DT_ADAPT
  type-name: foc::MotorDevice
  init: true
  readiness: is-initialized
  requires:
    - phandle: pwm-dev
    - phandle: adc-dev
  init-level: application
  init-priority: 80
```

## embedded/dts/bindings/gimbal/gimbal,hall-angle.yaml
```yaml
description: Dual analog Hall continuous-angle sensor

compatible: "rtos_sdk,gimbal-hall-angle"

include: base.yaml

properties:
  adc-dev:
    type: phandle
    required: true
    description: ADC controller used by both Hall channels

  channel-a:
    type: int
    required: true
    description: First Hall ADC channel index

  channel-b:
    type: int
    required: true
    description: Quadrature Hall ADC channel index

  sample-time:
    type: int
    required: true
    description: ADC acquisition-time enum from Cycles4 through Cycles480

cxx-driver:
  adapter:
    header: device_adapters/gimbal_hall_dt.h
    macro: HAL_GIMBAL_HALL_DT_ADAPT
  type-name: gimbal::HallAdcDevice
  init: true
  readiness: is-initialized
  requires:
    - phandle: adc-dev
  init-level: application
  init-priority: 70
```

## embedded/dts/bindings/gimbal/gimbal,voltage-motor.yaml
```yaml
description: Hall-sensored three-phase voltage FOC motor

compatible: "rtos_sdk,gimbal-voltage-motor"

include: base.yaml

properties:
  pwm-dev:
    type: phandle
    required: true
    description: Three-phase PWM timer

  pwm-ch-u:
    type: int
    required: true

  pwm-ch-v:
    type: int
    required: true

  pwm-ch-w:
    type: int
    required: true

  pwm-period-counts:
    type: int
    required: true
    description: Timer reload period used for duty conversion

  nominal-bus-mv:
    type: int
    required: true
    description: Nominal bus voltage when bus sensing is unavailable

  maximum-modulation-milli:
    type: int
    required: true
    description: Maximum fraction of the SVPWM linear vector radius in per mille

cxx-driver:
  adapter:
    header: device_adapters/gimbal_motor_dt.h
    macro: HAL_GIMBAL_MOTOR_DT_ADAPT
  type-name: foc::VoltageMotorDevice
  init: false
  readiness: is-initialized
  requires:
    - phandle: pwm-dev
  init-level: application
  init-priority: 80
```

## embedded/dts/bindings/imu/invensense,icm40609d.yaml
```yaml
# SPDX-License-Identifier: Apache-2.0

description: InvenSense ICM40609D 6-axis IMU (SPI interface)

compatible: "invensense,icm40609d"

on-bus: spi

include: [spi-device.yaml]

properties:
  accel-fs:
    type: int
    default: 0
    description: Accelerometer full-scale range (0=±2g, 1=±4g, 2=±8g, 3=±16g)
  gyro-fs:
    type: int
    default: 0
    description: Gyroscope full-scale range (0=±2000, 1=±1000, 2=±500, 3=±250 dps)
  sample-rate:
    type: int
    default: 16000
    enum: [25, 50, 100, 200, 500, 1000, 2000, 4000, 8000, 16000, 32000]
    description: Common accelerometer and gyroscope output data rate in Hz
  cs-gpios:
    type: phandle-array
    required: true
    description: Manual chip-select GPIO

cxx-driver:
  adapter:
    header: device_adapters/icm40609d_dt.h
    macro: HAL_ICM40609D_DT_ADAPT
  type-name: imu::Icm40609d
  init: true
  readiness: is-initialized
  requires:
    - parent
    - phandle-array: cs-gpios
      lifecycle: external
  # SPI transfers use OSAL locking and completion primitives.
  init-level: post-kernel
  init-priority: 20
```

## embedded/dts/bindings/input/gpio-keys.yaml
```yaml
# SPDX-License-Identifier: Apache-2.0

description: |
  GPIO-connected keys or buttons.

  Each key is defined in a child node of the gpio-keys node. The child node
  exposes a single GPIO as a generated C++ GpioPort device, matching the
  gpio-leds style used by board demos.

compatible: "gpio-keys"

child-binding:
  description: GPIO key child node

  include:
    - name: pinctrl-device.yaml

  properties:
    gpios:
      type: phandle-array
      required: true

    label:
      type: string

cxx-driver:
  adapter:
    header: device_adapters/gpio_dt.h
    macro: HAL_GPIO_DT_ADAPT
  type-name: GpioPort
  scope: children
  readiness: always-ready
  requires:
    - phandle-array: gpios
      lifecycle: external
```
