## embedded/soc/goodix/Kconfig
```kconfig
rsource "Kconfig.soc"

config SOC_SERIES_GR5525X
    bool "Goodix GR5525x series"
    select ARM
    select CPU_CORTEX_M4
    select CPU_HAS_FPU
    select CPU_HAS_ARM_MPU
    select SOC_FAMILY_GOODIX
    help
      Goodix GR5525x BLE SoC series

if SOC_SERIES_GR5525X

rsource "Kconfig.defconfig"

rsource "gr5525x/Kconfig"

config SOC_SERIES
    default "gr5525x"

endif # SOC_SERIES_GR5525X
```

## embedded/soc/goodix/Kconfig.defconfig
```kconfig
if SOC_FAMILY_GOODIX

# Source series Kconfig files first, so SoCs
# can override the defaults given here
rsource "*/Kconfig.defconfig"

config SYS_CLOCK_HW_CYCLES_PER_SEC
    default 96000000

config SYS_CLOCK_TICKS_PER_SEC
    default 1000

endif # SOC_FAMILY_GOODIX
```

## embedded/soc/goodix/Kconfig.soc
```kconfig
# Goodix SoC configuration

config SOC_FAMILY_GOODIX
    bool

config SOC_VENDOR
    string
    default "goodix" if SOC_SERIES_GR5525X

config SOC_FAMILY
    default "goodix" if SOC_FAMILY_GOODIX
```

## embedded/soc/goodix/gr5525x/Kconfig
```kconfig
# Goodix GR5525x series SoC configuration

config SOC_GR5525X
    bool
    select ARM
    select CPU_CORTEX_M4
    select CPU_HAS_FPU

config SOC
    string
    default "gr5525x"

config SOC_NAME
    string
    default "GR5525X"

# ── GR5525 Boot / Security ──

config GR5525_BOOT_CHECK_IMAGE
    bool "Bootloader image check"
    default y
    help
      Enable bootloader image integrity check before booting.

config GR5525_BOOT_LONG_TIME
    bool "Boot delay for debugger"
    default n
    help
      Add boot delay to allow debugger attachment.

config GR5525_SECURITY_CFG
    int "Security configuration"
    default 0
    help
      Security boot mode: 0=RSA-PKCS1-v2.1, non-zero=ECDSA.
```

## embedded/soc/goodix/gr5525x/Kconfig.defconfig
```kconfig
# Goodix GR5525x series SoC defconfig

if SOC_SERIES_GR5525X

config ROM_START_OFFSET
    hex
    default 0x0

config SYS_CLOCK_HW_CYCLES_PER_SEC
    default 96000000

config NUM_IRQS
    default 64

endif # SOC_SERIES_GR5525X
```

## embedded/soc/st/Kconfig.defconfig
```kconfig
if SOC_FAMILY_STM32

# Source series Kconfig files first, so SoCs
# can override the defaults given here
rsource "*/Kconfig.defconfig"

config CACHE_STM32
	default y if EXTERNAL_CACHE

config CLOCK_CONTROL
	default y

config SYS_CLOCK_HW_CYCLES_PER_SEC
	default 64000000

config SYS_CLOCK_TICKS_PER_SEC
	default 8000

config CLOCK_CONTROL_INIT_PRIORITY
	int
	default 1
	depends on CLOCK_CONTROL

config FLASH_BASE_ADDRESS
	hex
	default 0x08000000

config STM32_BACKUP_PROTECTION
	bool
	default y if !SOC_SERIES_STM32C0X && !SOC_SERIES_STM32WB0X

endif # SOC_FAMILY_STM32
```

## embedded/system/KConfig
```kconfig
menu "System Configure"

menu "Mempool Config"

config MEMPOOL_NORMAL_SIZE
    int "MEMPOOL_NORMAL_SIZE(KB)"
    default 8

config MEMPOOL_HIGHSPEED_SIZE
    int "MEMPOOL_HIGHSPEED_SIZE(KB)"
    default 0

config MEMPOOL_DMA_SIZE
    int "MEMPOOL_DMA_SIZE(KB)"
    default 4

endmenu

endmenu
```

## kernel/Kconfig
```kconfig
# Kernel configuration options

menu "General Kernel Options"

config MULTITHREADING
    bool "Multi-threading"
    default y
    help
      If disabled, only the main thread is available.

config NUM_COOP_PRIORITIES
    int "Number of coop priorities"
    default 16
    range 0 128
    help
      Number of cooperative priorities configured in the system.

config NUM_PREEMPT_PRIORITIES
    int "Number of preemptible priorities"
    default 15
    range 0 127
    help
      Number of preemptible priorities available in the system.

config MAIN_THREAD_PRIORITY
    int "Priority of initialization/main thread"
    default 0
    help
      Priority at which the initialization thread runs.

endmenu

menu "Memory Management"

config HEAP_MEM_POOL_SIZE
    int "System heap memory pool size (bytes)"
    default 0
    help
      Size of the system heap memory pool. Set to 0 to disable.

config MAX_THREAD_BYTES
    int "Maximum number of thread bytes"
    default 1
    help
      Maximum number of bytes used for thread bitmaps.

endmenu

menu "Userspace"

config USERSPACE
    bool "User mode threads"
    depends on ARCH_HAS_USERSPACE
    help
      When enabled, threads may be created or dropped down to user mode.

config PRIVILEGED_STACK_SIZE
    int "Size of privileged stack"
    default 1024
    depends on USERSPACE
    help
      Size of the privileged stack region for user mode threads.

config MAX_DOMAIN_PARTITIONS
    int "Maximum number of memory domain partitions"
    default 6
    depends on USERSPACE
    help
      Maximum number of partitions in a memory domain.

config GEN_PRIV_STACKS
    bool "Generate privileged stacks"
    depends on USERSPACE
    default y
    help
      Generate privileged stacks for user mode threads.

endmenu

menu "Thread Options"

config THREAD_NAME
    bool "Thread name support"
    default y
    help
      Enable thread name support.

config THREAD_MAX_NAME_LEN
    int "Maximum thread name length"
    default 32
    depends on THREAD_NAME
    help
      Maximum length of thread names.

config THREAD_MONITOR
    bool "Thread monitor"
    default n
    help
      Enable thread monitoring support.

endmenu

menu "Timer Options"

config SYS_CLOCK_TICKS_PER_SEC
    int "System clock ticks per second"
    default 100
    help
      Number of system clock ticks per second.

endmenu

menu "Interrupt Options"

config ZERO_LATENCY_IRQS
    bool "Zero latency interrupt support"
    depends on ARCH_HAS_ZERO_LATENCY_IRQS
    help
      Enable zero latency interrupt support.

config ZERO_LATENCY_LEVELS
    int "Number of zero latency interrupt priority levels"
    default 1
    depends on ZERO_LATENCY_IRQS
    help
      Number of interrupt priority levels reserved for zero latency.

endmenu
```
