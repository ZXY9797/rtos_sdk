/dts-v1/;
#include <st/h7/stm32h743.dtsi>
#include <st/h7/pinctrl/stm32h743vgtx-pinctrl.dtsi>

/ {
    model = "My Custom Board";
    compatible = "st,stm32h743";

    soc {
        #address-cells = <1>;
        #size-cells = <1>;
    };
};

&rcc {
	clocks = <&pll>;
	clock-frequency = <DT_FREQ_M(480)>;
	d1cpre = <1>;
	hpre = <2>;
	d1ppre = <2>;
	d2ppre1 = <2>;
	d2ppre2 = <2>;
	d3ppre = <2>;
};

&usart1 {
    pinctrl-0 = <&usart3_tx_pd8 &usart3_rx_pd9>;
    pinctrl-names = "default";
    current-speed = <115200>;
    status = "okay";
};